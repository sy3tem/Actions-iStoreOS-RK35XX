/dts-v1/;

/ {
	#address-cells = <0x02>;
	#size-cells = <0x02>;
	compatible = "hugsun,rt28", "rockchip,rk3528";
	interrupt-parent = <0x01>;
	model = "Hugsun RT28 AX3000 Router";

	acodec-sound {
		compatible = "simple-audio-card";
		simple-audio-card,format = "i2s";
		simple-audio-card,mclk-fs = <0x100>;
		simple-audio-card,name = "rk3528-acodec";
		status = "okay";

		simple-audio-card,codec {
			sound-dai = <0x8d>;
		};

		simple-audio-card,cpu {
			sound-dai = <0x8c>;
		};
	};

	acodec@ffe10000 {
		#sound-dai-cells = <0x00>;
		clock-names = "pclk", "mclk";
		clocks = <0x02 0xb2 0x02 0xb3>;
		compatible = "rockchip,rk3528-codec";
		pa-ctl-gpios = <0x3f 0x00 0x00>;
		phandle = <0x8d>;
		reg = <0x00 0xffe10000 0x00 0x1000>;
		reset-names = "acodec";
		resets = <0x02 0x1ad>;
		status = "okay";
	};

	adc-keys {
		compatible = "adc-keys";
		io-channel-names = "buttons";
		io-channels = <0x8e 0x01>;
		keyup-threshold-microvolt = <0x1b7740>;
		poll-interval = <0x64>;
		status = "okay";

		vol-up-key {
			label = "resatrt";
			linux,code = <0x198>;
			press-threshold-microvolt = <0x6d6>;
		};
	};

	aliases {
		ethernet0 = "/ethernet@ffbd0000";
		ethernet1 = "/ethernet@ffbe0000";
		gpio0 = "/pinctrl/gpio@ff610000";
		gpio1 = "/pinctrl/gpio@ffaf0000";
		gpio2 = "/pinctrl/gpio@ffb00000";
		gpio3 = "/pinctrl/gpio@ffb10000";
		gpio4 = "/pinctrl/gpio@ffb20000";
		i2c0 = "/i2c@ffa50000";
		i2c1 = "/i2c@ffa58000";
		i2c2 = "/i2c@ffa60000";
		i2c3 = "/i2c@ffa68000";
		i2c4 = "/i2c@ffa70000";
		i2c5 = "/i2c@ffa78000";
		i2c6 = "/i2c@ffa80000";
		i2c7 = "/i2c@ffa88000";
		serial0 = "/serial@ff9f0000";
		serial1 = "/serial@ff9f8000";
		serial2 = "/serial@ffa00000";
		serial3 = "/serial@ffa08000";
		serial4 = "/serial@ffa10000";
		serial5 = "/serial@ffa18000";
		serial6 = "/serial@ffa20000";
		serial7 = "/serial@ffa28000";
		spi0 = "/spi@ff9c0000";
		spi1 = "/spi@ff9d0000";
		spi2 = "/spi@ffc00000";
	};

	arm-pmu {
		compatible = "arm,cortex-a53-pmu";
		interrupt-affinity = <0x03 0x04 0x05 0x06>;
		interrupts = <0x00 0xab 0x04 0x00 0xac 0x04 0x00 0xad 0x04 0x00 0xae 0x04>;
	};

	avsd_plus@ff7c1000 {
		assigned-clock-rates = <0x11e1a300>;
		assigned-clocks = <0x02 0x9c>;
		clock-names = "aclk_vcodec", "hclk_vcodec";
		clocks = <0x02 0x9c 0x02 0x9d>;
		compatible = "rockchip,avs-plus-decoder";
		interrupt-names = "irq_dec";
		interrupts = <0x00 0x62 0x04>;
		iommus = <0x33>;
		reg = <0x00 0xff7c1000 0x00 0x200>;
		reset-names = "shared_video_a", "shared_video_h";
		resets = <0x02 0x199 0x02 0x19a>;
		rockchip,disable-auto-freq;
		rockchip,normal-rates = <0x11e1a300 0x00>;
		rockchip,resetgroup-node = <0x02>;
		rockchip,srv = <0x30>;
		rockchip,taskqueue-node = <0x02>;
		status = "okay";
	};

	bt-sco {
		#sound-dai-cells = <0x01>;
		compatible = "delta,dfbmcs320";
		phandle = <0x90>;
		status = "disabled";
	};

	bt-sound {
		compatible = "simple-audio-card";
		simple-audio-card,bitclock-inversion = <0x00>;
		simple-audio-card,format = "dsp_a";
		simple-audio-card,mclk-fs = <0x100>;
		simple-audio-card,name = "rockchip,bt";
		status = "disabled";

		simple-audio-card,codec {
			sound-dai = <0x90 0x01>;
		};

		simple-audio-card,cpu {
			sound-dai = <0x8f>;
		};
	};

	chosen {
		bootargs = "earlycon=uart8250,mmio32,0xff9f0000 console=ttyFIQ0 root=PARTUUID=614e0000-0000 rw rootwait";
	};

	clock-controller@ff4a0000 {
		#clock-cells = <0x01>;
		#reset-cells = <0x01>;
		assigned-clock-rates = <0x8000 0x46cf7100 0x3b9aca00 0x3b5dc100 0xee6b280 0x1dcd6500 0x2faf080 0x5f5e100 0x8f0d180 0xbebc200 0x11e1a300 0x1443fd00 0x17d78400 0x23c34600 0x2faf080 0x5f5e100 0x7735940 0x1dcd6500 0x1443fd00 0x11e1a300 0xbebc200>;
		assigned-clocks = <0x02 0x1ff 0x02 0x03 0x02 0x04 0x02 0x02 0x02 0x0d 0x02 0x11 0x02 0x09 0x02 0x0a 0x02 0x0b 0x02 0x0c 0x02 0x0e 0x02 0x0f 0x02 0x10 0x02 0x12 0x02 0x90 0x02 0x8f 0x02 0x95 0x02 0x55 0x02 0x144 0x02 0x96 0x02 0x93>;
		compatible = "rockchip,rk3528-cru";
		phandle = <0x02>;
		reg = <0x00 0xff4a0000 0x00 0x30000>;
		rockchip,grf = <0x0f>;
	};

	clocks {
		#address-cells = <0x02>;
		#size-cells = <0x02>;
		compatible = "simple-bus";
		ranges;

		mclkin-sai0 {
			#clock-cells = <0x00>;
			clock-frequency = <0x00>;
			clock-output-names = "i2s0_mclkin";
			compatible = "fixed-clock";
		};

		mclkin-sai1 {
			#clock-cells = <0x00>;
			clock-frequency = <0x00>;
			clock-output-names = "i2s1_mclkin";
			compatible = "fixed-clock";
		};

		mclkout-sai0@ff340014 {
			#clock-cells = <0x00>;
			clock-output-names = "mclk_sai0_to_io";
			clocks = <0x02 0xaf>;
			compatible = "rockchip,clk-out";
			reg = <0x00 0xff340014 0x00 0x04>;
			rockchip,bit-set-to-disable;
			rockchip,bit-shift = <0x01>;
		};

		mclkout-sai1@ff320004 {
			#clock-cells = <0x00>;
			clock-output-names = "mclk_sai1_to_io";
			clocks = <0x02 0x123>;
			compatible = "rockchip,clk-out";
			reg = <0x00 0xff320004 0x00 0x04>;
			rockchip,bit-set-to-disable;
			rockchip,bit-shift = <0x0e>;
		};

		xin24m {
			#clock-cells = <0x00>;
			clock-frequency = <0x16e3600>;
			clock-output-names = "xin24m";
			compatible = "fixed-clock";
			phandle = <0x81>;
		};
	};

	cpu0-opp-table {
		compatible = "operating-points-v2";
		mbist-vmin = <0xc96a8 0xe1d48 0xee098>;
		nvmem-cell-names = "leakage", "opp-info", "mbist-vmin";
		nvmem-cells = <0x0c 0x0d 0x0e>;
		opp-shared;
		phandle = <0x08>;
		rockchip,grf = <0x0f>;
		rockchip,low-temp = <0x2710>;
		rockchip,low-temp-min-volt = <0xdbba0>;
		rockchip,pvtm-freq = <0x188940>;
		rockchip,pvtm-offset = <0x18>;
		rockchip,pvtm-pvtpll;
		rockchip,pvtm-ref-temp = <0x28>;
		rockchip,pvtm-sample-time = <0x44c>;
		rockchip,pvtm-temp-prop = <0x00 0x00>;
		rockchip,pvtm-thermal-zone = "soc-thermal";
		rockchip,pvtm-volt = <0xdbba0>;
		rockchip,pvtm-voltage-sel = <0x00 0x528 0x00 0x529 0x546 0x01 0x547 0x55f 0x02 0x560 0x57d 0x03 0x57e 0x59b 0x04 0x59c 0x5be 0x05 0x5bf 0x5e1 0x06 0x5e2 0x604 0x07 0x605 0x627 0x08 0x628 0x64a 0x09 0x64b 0x668 0x0a 0x669 0x270f 0x0b>;
		rockchip,temp-hysteresis = <0x1388>;
		rockchip,video-4k-freq = <0x124f80>;

		opp-1008000000 {
			clock-latency-ns = <0x9c40>;
			opp-hz = <0x00 0x3c14dc00>;
			opp-microvolt = <0xc96a8 0xc96a8 0x10c8e0>;
			opp-microvolt-L0 = <0xd59f8 0xd59f8 0x10c8e0>;
			opp-microvolt-L1 = <0xd59f8 0xd59f8 0x10c8e0>;
			opp-microvolt-L2 = <0xd59f8 0xd59f8 0x10c8e0>;
			opp-microvolt-L3 = <0xd59f8 0xd59f8 0x10c8e0>;
			opp-microvolt-L4 = <0xd59f8 0xd59f8 0x10c8e0>;
			opp-microvolt-L5 = <0xcf850 0xcf850 0x10c8e0>;
		};

		opp-1200000000 {
			clock-latency-ns = <0x9c40>;
			opp-hz = <0x00 0x47868c00>;
			opp-microvolt = <0xc96a8 0xc96a8 0x10c8e0>;
			opp-microvolt-L0 = <0xdbba0 0xdbba0 0x10c8e0>;
			opp-microvolt-L1 = <0xd8acc 0xd8acc 0x10c8e0>;
			opp-microvolt-L2 = <0xd59f8 0xd59f8 0x10c8e0>;
			opp-microvolt-L3 = <0xd59f8 0xd59f8 0x10c8e0>;
			opp-microvolt-L4 = <0xd59f8 0xd59f8 0x10c8e0>;
			opp-microvolt-L5 = <0xd2924 0xd2924 0x10c8e0>;
			opp-microvolt-L6 = <0xcf850 0xcf850 0x10c8e0>;
		};

		opp-1416000000 {
			clock-latency-ns = <0x9c40>;
			opp-hz = <0x00 0x54667200>;
			opp-microvolt = <0xeafc4 0xeafc4 0x10c8e0>;
			opp-microvolt-L1 = <0xe7ef0 0xe7ef0 0x10c8e0>;
			opp-microvolt-L10 = <0xcf850 0xcf850 0x10c8e0>;
			opp-microvolt-L11 = <0xcf850 0xcf850 0x10c8e0>;
			opp-microvolt-L2 = <0xe7ef0 0xe7ef0 0x10c8e0>;
			opp-microvolt-L3 = <0xe4e1c 0xe4e1c 0x10c8e0>;
			opp-microvolt-L4 = <0xe1d48 0xe1d48 0x10c8e0>;
			opp-microvolt-L5 = <0xdec74 0xdec74 0x10c8e0>;
			opp-microvolt-L6 = <0xdbba0 0xdbba0 0x10c8e0>;
			opp-microvolt-L7 = <0xd8acc 0xd88d8 0x10c8e0>;
			opp-microvolt-L8 = <0xd59f8 0xd59f8 0x10c8e0>;
			opp-microvolt-L9 = <0xd2924 0xd2924 0x10c8e0>;
		};

		opp-1608000000 {
			clock-latency-ns = <0x9c40>;
			opp-hz = <0x00 0x5fd82200>;
			opp-microvolt = <0xf7314 0xf7314 0x10c8e0>;
			opp-microvolt-L10 = <0xdbba0 0xdbba0 0x10c8e0>;
			opp-microvolt-L11 = <0xd8acc 0xd8acc 0x10c8e0>;
			opp-microvolt-L2 = <0xf4240 0xf4240 0x10c8e0>;
			opp-microvolt-L3 = <0xf116c 0xf116c 0x10c8e0>;
			opp-microvolt-L4 = <0xee098 0xee098 0x10c8e0>;
			opp-microvolt-L5 = <0xeafc4 0xeafc4 0x10c8e0>;
			opp-microvolt-L6 = <0xe7ef0 0xe7ef0 0x10c8e0>;
			opp-microvolt-L7 = <0xe4e1c 0xe4e1c 0x10c8e0>;
			opp-microvolt-L8 = <0xe1d48 0xe1d48 0x10c8e0>;
			opp-microvolt-L9 = <0xdec74 0xdec74 0x10c8e0>;
		};

		opp-1800000000 {
			clock-latency-ns = <0x9c40>;
			opp-hz = <0x00 0x6b49d200>;
			opp-microvolt = <0x103664 0x103664 0x10c8e0>;
			opp-microvolt-L1 = <0x100590 0x100590 0x10c8e0>;
			opp-microvolt-L10 = <0xe4e1c 0xe4e1c 0x10c8e0>;
			opp-microvolt-L11 = <0xe1d48 0xe1d48 0x10c8e0>;
			opp-microvolt-L2 = <0xfd4bc 0xfd4bc 0x10c8e0>;
			opp-microvolt-L3 = <0xfa3e8 0xfa3e8 0x10c8e0>;
			opp-microvolt-L4 = <0xf7314 0xf7314 0x10c8e0>;
			opp-microvolt-L5 = <0xf4240 0xf4240 0x10c8e0>;
			opp-microvolt-L6 = <0xf116c 0xf116c 0x10c8e0>;
			opp-microvolt-L7 = <0xee098 0xee098 0x10c8e0>;
			opp-microvolt-L8 = <0xeafc4 0xeafc4 0x10c8e0>;
			opp-microvolt-L9 = <0xe7ef0 0xe7ef0 0x10c8e0>;
		};

		opp-2016000000 {
			clock-latency-ns = <0x9c40>;
			opp-hz = <0x00 0x7829b800>;
			opp-microvolt = <0x10c8e0 0x10c8e0 0x10c8e0>;
			opp-microvolt-L1 = <0x10980c 0x10980c 0x10c8e0>;
			opp-microvolt-L10 = <0xee098 0xee098 0x10c8e0>;
			opp-microvolt-L11 = <0xeafc4 0xeafc4 0x10c8e0>;
			opp-microvolt-L2 = <0x106738 0x106738 0x10c8e0>;
			opp-microvolt-L3 = <0x103664 0x103664 0x10c8e0>;
			opp-microvolt-L4 = <0x100590 0x100590 0x10c8e0>;
			opp-microvolt-L5 = <0xfd4bc 0xfd4bc 0x10c8e0>;
			opp-microvolt-L6 = <0xfa3e8 0xfa3e8 0x10c8e0>;
			opp-microvolt-L7 = <0xf7314 0xf7314 0x10c8e0>;
			opp-microvolt-L8 = <0xf4240 0xf4240 0x10c8e0>;
			opp-microvolt-L9 = <0xf116c 0xf116c 0x10c8e0>;
		};

		opp-408000000 {
			clock-latency-ns = <0x9c40>;
			opp-hz = <0x00 0x18519600>;
			opp-microvolt = <0xc96a8 0xc96a8 0x10c8e0>;
			opp-microvolt-L0 = <0xd59f8 0xd59f8 0x10c8e0>;
			opp-microvolt-L1 = <0xd59f8 0xd59f8 0x10c8e0>;
			opp-microvolt-L2 = <0xd59f8 0xd59f8 0x10c8e0>;
			opp-microvolt-L3 = <0xd59f8 0xd59f8 0x10c8e0>;
			opp-microvolt-L4 = <0xd59f8 0xd59f8 0x10c8e0>;
			opp-microvolt-L5 = <0xcf850 0xcf850 0x10c8e0>;
			opp-suspend;
		};

		opp-600000000 {
			clock-latency-ns = <0x9c40>;
			opp-hz = <0x00 0x23c34600>;
			opp-microvolt = <0xc96a8 0xc96a8 0x10c8e0>;
			opp-microvolt-L0 = <0xd59f8 0xd59f8 0x10c8e0>;
			opp-microvolt-L1 = <0xd59f8 0xd59f8 0x10c8e0>;
			opp-microvolt-L2 = <0xd59f8 0xd59f8 0x10c8e0>;
			opp-microvolt-L3 = <0xd59f8 0xd59f8 0x10c8e0>;
			opp-microvolt-L4 = <0xd59f8 0xd59f8 0x10c8e0>;
			opp-microvolt-L5 = <0xcf850 0xcf850 0x10c8e0>;
		};

		opp-816000000 {
			clock-latency-ns = <0x9c40>;
			opp-hz = <0x00 0x30a32c00>;
			opp-microvolt = <0xc96a8 0xc96a8 0x10c8e0>;
			opp-microvolt-L0 = <0xd59f8 0xd59f8 0x10c8e0>;
			opp-microvolt-L1 = <0xd59f8 0xd59f8 0x10c8e0>;
			opp-microvolt-L2 = <0xd59f8 0xd59f8 0x10c8e0>;
			opp-microvolt-L3 = <0xd59f8 0xd59f8 0x10c8e0>;
			opp-microvolt-L4 = <0xd59f8 0xd59f8 0x10c8e0>;
			opp-microvolt-L5 = <0xcf850 0xcf850 0x10c8e0>;
		};
	};

	cpuinfo {
		compatible = "rockchip,cpuinfo";
		nvmem-cell-names = "id", "cpu-version", "cpu-code";
		nvmem-cells = <0x10 0x11 0x12>;
	};

	cpus {
		#address-cells = <0x02>;
		#size-cells = <0x00>;

		cpu-map {

			cluster0 {

				core0 {
					cpu = <0x03>;
				};

				core1 {
					cpu = <0x04>;
				};

				core2 {
					cpu = <0x05>;
				};

				core3 {
					cpu = <0x06>;
				};
			};
		};

		cpu@0 {
			#cooling-cells = <0x02>;
			clocks = <0x07 0x15>;
			compatible = "arm,cortex-a53";
			cpu-idle-states = <0x09>;
			cpu-supply = <0x0a>;
			device_type = "cpu";
			dynamic-power-coefficient = <0x93>;
			enable-method = "psci";
			operating-points-v2 = <0x08>;
			phandle = <0x03>;
			reg = <0x00 0x00>;
		};

		cpu@1 {
			clocks = <0x07 0x15>;
			compatible = "arm,cortex-a53";
			cpu-idle-states = <0x09>;
			device_type = "cpu";
			enable-method = "psci";
			operating-points-v2 = <0x08>;
			phandle = <0x04>;
			reg = <0x00 0x01>;
		};

		cpu@2 {
			clocks = <0x07 0x15>;
			compatible = "arm,cortex-a53";
			cpu-idle-states = <0x0b>;
			device_type = "cpu";
			enable-method = "psci";
			operating-points-v2 = <0x08>;
			phandle = <0x05>;
			reg = <0x00 0x02>;
		};

		cpu@3 {
			clocks = <0x07 0x15>;
			compatible = "arm,cortex-a53";
			cpu-idle-states = <0x0b>;
			device_type = "cpu";
			enable-method = "psci";
			operating-points-v2 = <0x08>;
			phandle = <0x06>;
			reg = <0x00 0x03>;
		};

		idle-states {
			entry-method = "psci";

			cpu-sleep {
				arm,psci-suspend-param = <0x10000>;
				compatible = "arm,idle-state";
				entry-latency-us = <0x78>;
				exit-latency-us = <0xfa>;
				local-timer-stop;
				min-residency-us = <0x384>;
				phandle = <0x0b>;
				status = "okay";
			};

			cpu-sleep0 {
				arm,psci-suspend-param = <0x10000>;
				compatible = "arm,idle-state";
				entry-latency-us = <0x78>;
				exit-latency-us = <0xfa>;
				local-timer-stop;
				min-residency-us = <0x384>;
				phandle = <0x09>;
				status = "disabled";
			};
		};
	};

	crypto@ffc40000 {
		assigned-clock-rates = <0x11e1a300 0x11e1a300>;
		assigned-clocks = <0x07 0x17 0x07 0x19>;
		clock-names = "aclk", "hclk", "sclk", "pka";
		clocks = <0x07 0x18 0x07 0x1a 0x07 0x17 0x07 0x19>;
		compatible = "rockchip,crypto-v4";
		interrupts = <0x00 0x13 0x04>;
		reg = <0x00 0xffc40000 0x00 0x2000>;
		reset-names = "crypto-rst";
		resets = <0x02 0x3a>;
		status = "okay";
	};

	dc-12v {
		compatible = "regulator-fixed";
		phandle = <0x97>;
		regulator-always-on;
		regulator-boot-on;
		regulator-max-microvolt = <0xb71b00>;
		regulator-min-microvolt = <0xb71b00>;
		regulator-name = "dc_12v";
	};

	debug@ff190000 {
		compatible = "rockchip,debug";
		reg = <0x00 0xff190000 0x00 0x1000 0x00 0xff192000 0x00 0x1000 0x00 0xff194000 0x00 0x1000 0x00 0xff196000 0x00 0x1000>;
	};

	dfi@ff930000 {
		compatible = "rockchip,rk3528-dfi";
		phandle = <0x18>;
		reg = <0x00 0xff930000 0x00 0x400>;
		rockchip,grf = <0x0f>;
		status = "okay";
	};

	display-subsystem {
		compatible = "rockchip,display-subsystem";
		memory-region = <0x14 0x15>;
		memory-region-names = "drm-logo", "drm-cubic-lut";
		ports = <0x13>;
		status = "okay";

		route {

			route-hdmi {
				charge_logo,mode = "center";
				connect = <0x16>;
				logo,kernel = "logo_kernel.bmp";
				logo,mode = "center";
				logo,uboot = "logo.bmp";
				status = "okay";
			};

			route-tve {
				charge_logo,mode = "center";
				connect = <0x17>;
				logo,kernel = "logo_kernel.bmp";
				logo,mode = "center";
				logo,uboot = "logo.bmp";
				status = "okay";
			};
		};
	};

	dma-controller@ffd60000 {
		#dma-cells = <0x01>;
		arm,pl330-periph-burst;
		clock-names = "apb_pclk";
		clocks = <0x02 0x68>;
		compatible = "arm,pl330", "arm,primecell";
		interrupts = <0x00 0x00 0x04 0x00 0x01 0x04 0x00 0x02 0x04 0x00 0x03 0x04 0x00 0x04 0x04 0x00 0x05 0x04 0x00 0x06 0x04 0x00 0x07 0x04 0x00 0x10 0x04>;
		phandle = <0x40>;
		reg = <0x00 0xffd60000 0x00 0x4000>;
	};

	dmc {
		auto-freq-en = <0x00>;
		auto-min-freq = <0x4f1a0>;
		center-supply = <0x1a>;
		clock-names = "dmc_clk";
		clocks = <0x07 0x14>;
		compatible = "rockchip,rk3528-dmc";
		devfreq-events = <0x18>;
		downdifferential = <0x14>;
		interrupt-names = "complete";
		interrupts = <0x00 0x11 0x04>;
		operating-points-v2 = <0x19>;
		status = "okay";
		system-status-level = <0x01 0x08>;
		upthreshold = <0x28>;
	};

	dmc-opp-table {
		compatible = "operating-points-v2";
		mbist-vmin = <0xcf850 0xdbba0>;
		nvmem-cell-names = "leakage", "opp-info", "mbist-vmin";
		nvmem-cells = <0x1b 0x1c 0x1d>;
		phandle = <0x19>;
		rockchip,leakage-voltage-sel = <0x01 0x0a 0x00 0x0b 0x0e 0x01 0x0f 0x16 0x02 0x17 0x1c 0x03 0x1d 0xfe 0x04>;
		rockchip,low-temp = <0x2710>;
		rockchip,low-temp-min-volt = <0xdbba0>;
		rockchip,temp-hysteresis = <0x1388>;

		opp-1056000000 {
			opp-hz = <0x00 0x3ef14800>;
			opp-microvolt = <0xcf850 0xcf850 0xf4240>;
			opp-microvolt-L0 = <0xd59f8 0xd59f8 0xf4240>;
			opp-microvolt-L1 = <0xcf850 0xcf850 0xf4240>;
			opp-microvolt-L2 = <0xcf850 0xcf850 0xf4240>;
			opp-microvolt-L3 = <0xcf850 0xcf850 0xf4240>;
			opp-microvolt-L4 = <0xcf850 0xcf850 0xf4240>;
		};

		opp-1184000000 {
			opp-hz = <0x00 0x46926800>;
			opp-microvolt = <0xdbba0 0xdbba0 0xf4240>;
			opp-microvolt-L0 = <0xe7ef0 0xe7ef0 0xf4240>;
			opp-microvolt-L1 = <0xe1d48 0xe1d48 0xf4240>;
			opp-microvolt-L2 = <0xdbba0 0xdbba0 0xf4240>;
			opp-microvolt-L3 = <0xd59f8 0xd59f8 0xf4240>;
			opp-microvolt-L4 = <0xd2924 0xd2924 0xf4240>;
			status = "disabled";
		};

		opp-920000000 {
			opp-hz = <0x00 0x36d61600>;
			opp-microvolt = <0xcf850 0xcf850 0xf4240>;
		};
	};

	dummy-codec {
		#sound-dai-cells = <0x00>;
		compatible = "rockchip,dummy-codec";
		phandle = <0x94>;
		status = "disabled";
	};

	ethernet@ffbd0000 {
		clock-names = "stmmaceth", "clk_mac_ref", "mac_clk_rx", "mac_clk_tx", "pclk_mac", "aclk_mac";
		clock_in_out = "input";
		clocks = <0x02 0x17b 0x02 0x17c 0x02 0x17e 0x02 0x17d 0x02 0x17a 0x02 0x179>;
		compatible = "rockchip,rk3528-gmac", "snps,dwmac-4.20a";
		interrupt-names = "macirq", "eth_wake_irq";
		interrupts = <0x00 0x71 0x04 0x00 0x74 0x04>;
		nvmem-cell-names = "bgs";
		nvmem-cells = <0x73>;
		phy-handle = <0x72>;
		phy-mode = "rmii";
		reg = <0x00 0xffbd0000 0x00 0x10000>;
		reset-names = "stmmaceth";
		resets = <0x02 0x29a>;
		rockchip,grf = <0x0f>;
		snps,axi-config = <0x6f>;
		snps,mixed-burst;
		snps,mtl-rx-config = <0x70>;
		snps,mtl-tx-config = <0x71>;
		snps,tso;
		status = "disabled";

		mdio {
			#address-cells = <0x01>;
			#size-cells = <0x00>;
			compatible = "snps,dwmac-mdio";

			ethernet-phy@2 {
				clocks = <0x02 0x18e>;
				compatible = "ethernet-phy-id0044.1400", "ethernet-phy-ieee802.3-c22";
				nvmem-cell-names = "txlevel";
				nvmem-cells = <0x74>;
				phandle = <0x72>;
				phy-is-integrated;
				reg = <0x02>;
				resets = <0x02 0x2a3>;
				rockchip,thermal-zone = "soc-thermal";
			};
		};

		rx-queues-config {
			phandle = <0x70>;
			snps,rx-queues-to-use = <0x01>;

			queue0 {
			};
		};

		stmmac-axi-config {
			phandle = <0x6f>;
			snps,blen = <0x00 0x00 0x00 0x00 0x10 0x08 0x04>;
			snps,rd_osr_lmt = <0x08>;
			snps,wr_osr_lmt = <0x04>;
		};

		tx-queues-config {
			phandle = <0x71>;
			snps,tx-queues-to-use = <0x01>;

			queue0 {
			};
		};
	};

	ethernet@ffbe0000 {
		clock-names = "stmmaceth", "clk_mac_ref", "pclk_mac", "aclk_mac";
		clock_in_out = "output";
		clocks = <0x02 0xd2 0x02 0xd1 0x02 0xcf 0x02 0xce>;
		compatible = "rockchip,rk3528-gmac", "snps,dwmac-4.20a";
		interrupt-names = "macirq", "eth_wake_irq";
		interrupts = <0x00 0x79 0x04 0x00 0x7c 0x04>;
		phy-handle = <0x7e>;
		phy-mode = "rgmii-rxid";
		pinctrl-0 = <0x79 0x7a 0x7b 0x7c 0x7d>;
		pinctrl-names = "default";
		reg = <0x00 0xffbe0000 0x00 0x10000>;
		reset-names = "stmmaceth";
		resets = <0x02 0x1c5>;
		rockchip,grf = <0x0f>;
		snps,axi-config = <0x75>;
		snps,mixed-burst;
		snps,mtl-rx-config = <0x76>;
		snps,mtl-tx-config = <0x77>;
		snps,reset-active-low;
		snps,reset-delays-us = <0x00 0x4e20 0x186a0>;
		snps,reset-gpio = <0x78 0x0d 0x01>;
		snps,tso;
		status = "okay";
		tx_delay = <0x30>;

		fixed-link {
			full-duplex;
			speed = <0x3e8>;
		};

		mdio {
			#address-cells = <0x01>;
			#size-cells = <0x00>;
			compatible = "snps,dwmac-mdio";
			phandle = <0x9e>;

			phy@1 {
				compatible = "ethernet-phy-ieee802.3-c22";
				phandle = <0x7e>;
				reg = <0x01>;
			};
		};

		rx-queues-config {
			phandle = <0x76>;
			snps,rx-queues-to-use = <0x01>;

			queue0 {
			};
		};

		stmmac-axi-config {
			phandle = <0x75>;
			snps,blen = <0x00 0x00 0x00 0x00 0x10 0x08 0x04>;
			snps,rd_osr_lmt = <0x08>;
			snps,wr_osr_lmt = <0x04>;
		};

		tx-queues-config {
			phandle = <0x77>;
			snps,tx-queues-to-use = <0x01>;

			queue0 {
			};
		};
	};

	fiq-debugger {
		compatible = "rockchip,fiq-debugger";
		interrupts = <0x00 0xba 0x04>;
		pinctrl-0 = <0x9f>;
		pinctrl-names = "default";
		rockchip,baudrate = <0x16e360>;
		rockchip,irq-mode-enable = <0x01>;
		rockchip,serial-id = <0x00>;
		rockchip,wake-irq = <0x00>;
		status = "okay";
	};

	firmware {

		optee {
			compatible = "linaro,optee-tz";
			method = "smc";
		};

		scmi {
			#address-cells = <0x01>;
			#size-cells = <0x00>;
			arm,smc-id = <0x82000010>;
			compatible = "arm,scmi-smc";
			shmem = <0x1e>;

			protocol@14 {
				#clock-cells = <0x01>;
				assigned-clock-rates = <0x47868c00>;
				assigned-clocks = <0x07 0x15>;
				phandle = <0x07>;
				reg = <0x14>;
			};
		};
	};

	gpio-keys {
		autorepeat;
		compatible = "gpio-keys";

		wps_button {
			debounce-interval = <0x64>;
			gpios = <0x78 0x0e 0x01>;
			label = "GPIO wps";
			linux,code = <0x211>;
			wakeup-source;
		};
	};

	gpio-leds {
		compatible = "gpio-leds";
		status = "okay";

		link_blue {
			default-state = "on";
			gpios = <0x78 0x03 0x00>;
			linux,default-trigger = "none";
		};

		link_green {
			default-state = "on";
			gpios = <0x78 0x04 0x00>;
			linux,default-trigger = "none";
		};

		link_red {
			default-state = "on";
			gpios = <0x78 0x05 0x00>;
			linux,default-trigger = "none";
		};

		work_blue {
			default-state = "on";
			gpios = <0x78 0x00 0x00>;
			linux,default-trigger = "none";
		};

		work_green {
			default-state = "on";
			gpios = <0x78 0x01 0x00>;
			linux,default-trigger = "none";
		};

		work_red {
			default-state = "off";
			gpios = <0x78 0x02 0x00>;
			linux,default-trigger = "none";
		};
	};

	gpu-bus {
		bus-supply = <0x1a>;
		clock-names = "bus";
		clocks = <0x07 0x16>;
		compatible = "rockchip,rk3528-bus";
		operating-points-v2 = <0x2e>;
		rockchip,busfreq-policy = "clkfreq";
		status = "okay";
	};

	gpu-bus-opp-table {
		compatible = "operating-points-v2";
		nvmem-cell-names = "leakage";
		nvmem-cells = <0x1b>;
		phandle = <0x2e>;
		rockchip,leakage-voltage-sel = <0x01 0x16 0x00 0x17 0xfe 0x01>;

		opp-700000000 {
			opp-hz = <0x00 0x29b92700>;
			opp-microvolt = <0xcf850 0xcf850 0xf4240>;
		};

		opp-800000000 {
			opp-hz = <0x00 0x2faf0800>;
			opp-microvolt = <0xd59f8 0xd59f8 0xf4240>;
			opp-microvolt-L1 = <0xcf850 0xcf850 0xf4240>;
		};
	};

	gpu-opp-table {
		compatible = "operating-points-v2";
		mbist-vmin = <0xc96a8 0xe1d48>;
		nvmem-cell-names = "leakage", "opp-info", "mbist-vmin";
		nvmem-cells = <0x2b 0x2c 0x2d>;
		phandle = <0x2a>;
		rockchip,grf = <0x0f>;
		rockchip,low-temp = <0x2710>;
		rockchip,low-temp-min-volt = <0xdbba0>;
		rockchip,pvtm-freq = "", "\f5";
		rockchip,pvtm-offset = <0x10018>;
		rockchip,pvtm-pvtpll;
		rockchip,pvtm-ref-temp = <0x28>;
		rockchip,pvtm-sample-time = <0x44c>;
		rockchip,pvtm-temp-prop = <0x00 0x00>;
		rockchip,pvtm-thermal-zone = "soc-thermal";
		rockchip,pvtm-volt = <0xdbba0>;
		rockchip,pvtm-voltage-sel = <0x00 0x2ee 0x00 0x2ef 0x302 0x01 0x303 0x316 0x02 0x317 0x32a 0x03 0x32b 0x33e 0x04 0x33f 0x352 0x05 0x353 0x366 0x06 0x367 0x37a 0x07 0x37b 0x270f 0x08>;
		rockchip,temp-hysteresis = <0x1388>;

		opp-300000000 {
			opp-hz = <0x00 0x11e1a300>;
			opp-microvolt = <0xd59f8 0xd59f8 0xf4240>;
			opp-microvolt-L5 = <0xcf850 0xcf850 0xf4240>;
			opp-microvolt-L6 = <0xcc77c 0xcc77c 0xf4240>;
			opp-microvolt-L7 = <0xc96a8 0xc96a8 0xf4240>;
			opp-microvolt-L8 = <0xc96a8 0xc96a8 0xf4240>;
		};

		opp-500000000 {
			opp-hz = <0x00 0x1dcd6500>;
			opp-microvolt = <0xd59f8 0xd59f8 0xf4240>;
			opp-microvolt-L5 = <0xcf850 0xcf850 0xf4240>;
			opp-microvolt-L6 = <0xcc77c 0xcc77c 0xf4240>;
			opp-microvolt-L7 = <0xc96a8 0xc96a8 0xf4240>;
			opp-microvolt-L8 = <0xc96a8 0xc96a8 0xf4240>;
		};

		opp-600000000 {
			opp-hz = <0x00 0x23c34600>;
			opp-microvolt = <0xd59f8 0xd59f8 0xf4240>;
			opp-microvolt-L5 = <0xcf850 0xcf850 0xf4240>;
			opp-microvolt-L6 = <0xcc77c 0xcc77c 0xf4240>;
			opp-microvolt-L7 = <0xc96a8 0xc96a8 0xf4240>;
			opp-microvolt-L8 = <0xc96a8 0xc96a8 0xf4240>;
		};

		opp-700000000 {
			clock-latency-ns = <0x9c40>;
			opp-hz = <0x00 0x29b92700>;
			opp-microvolt = <0xdbba0 0xdbba0 0xf4240>;
			opp-microvolt-L1 = <0xd8acc 0xd8acc 0xf4240>;
			opp-microvolt-L2 = <0xd59f8 0xd59f8 0xf4240>;
			opp-microvolt-L3 = <0xd59f8 0xd59f8 0xf4240>;
			opp-microvolt-L4 = <0xd59f8 0xd59f8 0xf4240>;
			opp-microvolt-L5 = <0xcf850 0xcf850 0xf4240>;
			opp-microvolt-L6 = <0xcc77c 0xcc77c 0xf4240>;
			opp-microvolt-L7 = <0xc96a8 0xc96a8 0xf4240>;
			opp-microvolt-L8 = <0xc96a8 0xc96a8 0xf4240>;
		};

		opp-800000000 {
			clock-latency-ns = <0x9c40>;
			opp-hz = <0x00 0x2faf0800>;
			opp-microvolt = <0xe7ef0 0xe7ef0 0xf4240>;
			opp-microvolt-L1 = <0xe4e1c 0xe4e1c 0xf4240>;
			opp-microvolt-L2 = <0xe1d48 0xe1d48 0xf4240>;
			opp-microvolt-L3 = <0xdec74 0xdec74 0xf4240>;
			opp-microvolt-L4 = <0xdbba0 0xdbba0 0xf4240>;
			opp-microvolt-L5 = <0xd8acc 0xd8acc 0xf4240>;
			opp-microvolt-L6 = <0xd59f8 0xd59f8 0xf4240>;
			opp-microvolt-L7 = <0xd2924 0xd2924 0xf4240>;
			opp-microvolt-L8 = <0xcf850 0xcf850 0xf4240>;
		};
	};

	gpu@ff700000 {
		#cooling-cells = <0x02>;
		assigned-clock-rates = <0x11e1a300>;
		assigned-clocks = <0x07 0x16>;
		clock-names = "clk_mali", "aclk_gpu_mali", "pclk_gpu";
		clocks = <0x07 0x16 0x02 0x113 0x02 0x10e>;
		compatible = "arm,mali-450";
		interrupt-names = "Mali_GP_IRQ", "Mali_GP_MMU_IRQ", "IRQPP", "Mali_PP0_IRQ", "Mali_PP0_MMU_IRQ", "Mali_PP1_IRQ", "Mali_PP1_MMU_IRQ";
		interrupts = <0x00 0x58 0x04 0x00 0x59 0x04 0x00 0x56 0x04 0x00 0x5c 0x04 0x00 0x5d 0x04 0x00 0x5a 0x04 0x00 0x5b 0x04>;
		mali-supply = <0x1a>;
		operating-points-v2 = <0x2a>;
		phandle = <0x21>;
		power-domains = <0x29 0x04>;
		reg = <0x00 0xff700000 0x00 0x40000>;
		rockchip,grf = <0x0f>;
		status = "okay";

		power-model {
			compatible = "simple-power-model";
			dynamic-coefficient = <0x2d4>;
			leakage-range = <0x01 0x03>;
			ls = <0xffffc2d6 0x1071a 0x00>;
			static-coefficient = <0x2710>;
			thermal-zone = "soc-thermal";
			ts = <0x302a42 0x1d55a 0xfffff636 0x27>;
		};
	};

	hdcp2@ff8c0000 {
		clock-names = "aclk_hdcp2", "pclk_hdcp2", "hdcp2_clk_hdmi";
		clocks = <0x02 0x163 0x02 0x165 0x02 0x164>;
		compatible = "rockchip,rk3528-hdmi-hdcp2";
		interrupts = <0x00 0x68 0x04>;
		reg = <0x00 0xff8c0000 0x00 0x2000>;
		status = "disabled";
	};

	hdmi-sound {
		compatible = "rockchip,hdmi";
		rockchip,card-name = "rockchip,hdmi";
		rockchip,codec = <0x92>;
		rockchip,cpu = <0x91>;
		rockchip,jack-det;
		rockchip,mclk-fs = <0x80>;
	};

	hdmi@ff8d0000 {
		#sound-dai-cells = <0x00>;
		clock-names = "iahb", "isfr", "cec", "dclk_vp0";
		clocks = <0x02 0x158 0x02 0x159 0x02 0x15a 0x34>;
		compatible = "rockchip,rk3528-dw-hdmi";
		ddc-i2c-scl-high-time-ns = <0x2599>;
		ddc-i2c-scl-low-time-ns = <0x2710>;
		hpd-gpios = <0x3f 0x02 0x00>;
		interrupt-names = "hdmi", "hdmi_wakeup";
		interrupts = <0x00 0x66 0x04 0x00 0x67 0x04>;
		phandle = <0x92>;
		phy-names = "hdmi";
		phys = <0x3e>;
		pinctrl-0 = <0x3d>;
		pinctrl-names = "default";
		reg = <0x00 0xff8d0000 0x00 0x20000 0x00 0xff610000 0x00 0x200>;
		reg-io-width = <0x04>;
		rockchip,grf = <0x0f>;
		status = "okay";

		ports {
			#address-cells = <0x01>;
			#size-cells = <0x00>;

			port@0 {
				#address-cells = <0x01>;
				#size-cells = <0x00>;
				reg = <0x00>;

				endpoint@0 {
					phandle = <0x36>;
					reg = <0x00>;
					remote-endpoint = <0x16>;
					status = "okay";
				};
			};
		};
	};

	hdmiphy@ffe00000 {
		#phy-cells = <0x00>;
		clock-names = "sysclk", "refclk";
		clocks = <0x02 0x160 0x81>;
		compatible = "rockchip,rk3528-hdmi-phy";
		interrupts = <0x00 0x65 0x04>;
		phandle = <0x3e>;
		reg = <0x00 0xffe00000 0x00 0x10000>;
		status = "okay";

		clk-port {
			#clock-cells = <0x00>;
			clock-output-names = "clk_hdmiphy_pixel_io";
			phandle = <0x34>;
			status = "okay";
		};
	};

	hwspinlock@ffd70000 {
		#hwlock-cells = <0x01>;
		compatible = "rockchip,hwspinlock";
		reg = <0x00 0xffd70000 0x00 0x100>;
		status = "disabled";
	};

	i2c@ffa50000 {
		#address-cells = <0x01>;
		#size-cells = <0x00>;
		clock-names = "i2c", "pclk";
		clocks = <0x02 0x127 0x02 0x126>;
		compatible = "rockchip,rk3528-i2c", "rockchip,rk3399-i2c";
		interrupts = <0x00 0x3d 0x04>;
		pinctrl-0 = <0x47>;
		pinctrl-names = "default";
		reg = <0x00 0xffa50000 0x00 0x1000>;
		status = "disabled";
	};

	i2c@ffa58000 {
		#address-cells = <0x01>;
		#size-cells = <0x00>;
		clock-names = "i2c", "pclk";
		clocks = <0x02 0x125 0x02 0x124>;
		compatible = "rockchip,rk3528-i2c", "rockchip,rk3399-i2c";
		interrupts = <0x00 0x3e 0x04>;
		pinctrl-0 = <0x48>;
		pinctrl-names = "default";
		reg = <0x00 0xffa58000 0x00 0x1000>;
		status = "disabled";
	};

	i2c@ffa60000 {
		#address-cells = <0x01>;
		#size-cells = <0x00>;
		clock-names = "i2c", "pclk";
		clocks = <0x02 0x1f2 0x02 0x1f1>;
		compatible = "rockchip,rk3528-i2c", "rockchip,rk3399-i2c";
		interrupts = <0x00 0x3f 0x04>;
		pinctrl-0 = <0x49>;
		pinctrl-names = "default";
		reg = <0x00 0xffa60000 0x00 0x1000>;
		status = "disabled";
	};

	i2c@ffa68000 {
		#address-cells = <0x01>;
		#size-cells = <0x00>;
		clock-names = "i2c", "pclk";
		clocks = <0x02 0xc9 0x02 0xc8>;
		compatible = "rockchip,rk3528-i2c", "rockchip,rk3399-i2c";
		interrupts = <0x00 0x40 0x04>;
		pinctrl-0 = <0x4a>;
		pinctrl-names = "default";
		reg = <0x00 0xffa68000 0x00 0x1000>;
		status = "disabled";
	};

	i2c@ffa70000 {
		#address-cells = <0x01>;
		#size-cells = <0x00>;
		clock-names = "i2c", "pclk";
		clocks = <0x02 0x1a7 0x02 0x1a6>;
		compatible = "rockchip,rk3528-i2c", "rockchip,rk3399-i2c";
		interrupts = <0x00 0x41 0x04>;
		pinctrl-0 = <0x4b>;
		pinctrl-names = "default";
		reg = <0x00 0xffa70000 0x00 0x1000>;
		status = "disabled";
	};

	i2c@ffa78000 {
		#address-cells = <0x01>;
		#size-cells = <0x00>;
		clock-names = "i2c", "pclk";
		clocks = <0x02 0xcb 0x02 0xca>;
		compatible = "rockchip,rk3528-i2c", "rockchip,rk3399-i2c";
		interrupts = <0x00 0x42 0x04>;
		pinctrl-0 = <0x4c>;
		pinctrl-names = "default";
		reg = <0x00 0xffa78000 0x00 0x1000>;
		status = "disabled";
	};

	i2c@ffa80000 {
		#address-cells = <0x01>;
		#size-cells = <0x00>;
		clock-names = "i2c", "pclk";
		clocks = <0x02 0xcd 0x02 0xcc>;
		compatible = "rockchip,rk3528-i2c", "rockchip,rk3399-i2c";
		interrupts = <0x00 0x43 0x04>;
		pinctrl-0 = <0x4d>;
		pinctrl-names = "default";
		reg = <0x00 0xffa80000 0x00 0x1000>;
		status = "disabled";
	};

	i2c@ffa88000 {
		#address-cells = <0x01>;
		#size-cells = <0x00>;
		clock-names = "i2c", "pclk";
		clocks = <0x02 0x1a9 0x02 0x1a8>;
		compatible = "rockchip,rk3528-i2c", "rockchip,rk3399-i2c";
		interrupts = <0x00 0x44 0x04>;
		pinctrl-0 = <0x4e>;
		pinctrl-names = "default";
		reg = <0x00 0xffa88000 0x00 0x1000>;
		status = "disabled";
	};

	iep@ff860000 {
		assigned-clock-rates = <0x1443fd00 0x1443fd00>;
		assigned-clocks = <0x02 0x14e 0x02 0x14f>;
		clock-names = "aclk", "hclk", "sclk";
		clocks = <0x02 0x14e 0x02 0x14d 0x02 0x14f>;
		compatible = "rockchip,iep-v2";
		interrupts = <0x00 0x6a 0x04>;
		iommus = <0x39>;
		reg = <0x00 0xff860000 0x00 0x500>;
		reset-names = "shared_rst_a", "shared_rst_h", "shared_rst_s";
		resets = <0x02 0x27b 0x02 0x27a 0x02 0x27c>;
		rockchip,normal-rates = <0x1443fd00 0x00 0x1443fd00>;
		rockchip,resetgroup-node = <0x03>;
		rockchip,srv = <0x30>;
		rockchip,taskqueue-node = <0x03>;
		status = "okay";
	};

	interrupt-controller@fed01000 {
		#address-cells = <0x00>;
		#interrupt-cells = <0x03>;
		compatible = "arm,gic-400";
		interrupt-controller;
		interrupts = <0x01 0x09 0xf08>;
		phandle = <0x01>;
		reg = <0x00 0xfed01000 0x00 0x1000 0x00 0xfed02000 0x00 0x2000 0x00 0xfed04000 0x00 0x2000 0x00 0xfed06000 0x00 0x2000>;
	};

	iommu@ff740800 {
		#iommu-cells = <0x00>;
		clock-names = "aclk", "iface", "clk_hevc_cabac";
		clocks = <0x02 0x1b7 0x02 0x1b8 0x02 0x1b9>;
		compatible = "rockchip,iommu-v2";
		interrupt-names = "rkvdec_mmu";
		interrupts = <0x00 0x5f 0x04>;
		phandle = <0x2f>;
		reg = <0x00 0xff740800 0x00 0x40 0x00 0xff740900 0x00 0x40>;
		rockchip,shootdown-entire;
		status = "okay";
	};

	iommu@ff78f000 {
		#iommu-cells = <0x00>;
		clock-names = "aclk", "iface";
		clocks = <0x02 0x120 0x02 0x11f>;
		compatible = "rockchip,iommu-v2";
		interrupt-names = "rkvenc_mmu";
		interrupts = <0x00 0x60 0x04>;
		phandle = <0x32>;
		reg = <0x00 0xff78f000 0x00 0x40>;
		rockchip,shootdown-entire;
		status = "okay";
	};

	iommu@ff7c0800 {
		#iommu-cells = <0x00>;
		clock-names = "aclk", "iface";
		clocks = <0x02 0x9c 0x02 0x9d>;
		compatible = "rockchip,iommu-v2";
		interrupt-names = "vdpu_mmu";
		interrupts = <0x00 0x63 0x04>;
		phandle = <0x33>;
		reg = <0x00 0xff7c0800 0x00 0x40>;
		rockchip,shootdown-entire;
		status = "okay";
	};

	iommu@ff847e00 {
		#iommu-cells = <0x00>;
		clock-names = "aclk", "iface";
		clocks = <0x02 0x157 0x02 0x154>;
		compatible = "rockchip,iommu-v2";
		interrupt-names = "vop_mmu";
		interrupts = <0x00 0x6d 0x04>;
		phandle = <0x35>;
		reg = <0x00 0xff847e00 0x00 0x100>;
		rockchip,disable-device-link-resume;
		rockchip,shootdown-entire;
		status = "okay";
	};

	iommu@ff850f00 {
		#iommu-cells = <0x00>;
		clock-names = "aclk", "iface";
		clocks = <0x02 0x14b 0x02 0x14a>;
		compatible = "rockchip,iommu-v2";
		interrupt-names = "rga2_mmu";
		interrupts = <0x00 0x69 0x04>;
		phandle = <0x38>;
		reg = <0x00 0xff850f00 0x00 0x100>;
		status = "okay";
	};

	iommu@ff860800 {
		#iommu-cells = <0x00>;
		clock-names = "aclk", "iface";
		clocks = <0x02 0x14e 0x02 0x14d>;
		compatible = "rockchip,iommu-v2";
		interrupt-names = "iep_mmu";
		interrupts = <0x00 0x6a 0x04>;
		phandle = <0x39>;
		reg = <0x00 0xff860800 0x00 0x100>;
		rockchip,shootdown-entire;
		status = "okay";
	};

	iommu@ff870480 {
		#iommu-cells = <0x00>;
		clock-names = "aclk", "iface";
		clocks = <0x02 0x169 0x02 0x16a>;
		compatible = "rockchip,iommu-v2";
		interrupt-names = "jpegd_mmu";
		interrupts = <0x00 0x6c 0x04>;
		phandle = <0x3a>;
		reg = <0x00 0xff870480 0x00 0x40>;
		rockchip,shootdown-entire;
		status = "okay";
	};

	jpegd@ff870000 {
		assigned-clock-rates = <0x1443fd00>;
		assigned-clocks = <0x02 0x169>;
		clock-names = "aclk_vcodec", "hclk_vcodec";
		clocks = <0x02 0x169 0x02 0x16a>;
		compatible = "rockchip,rkv-jpeg-decoder-v1";
		interrupts = <0x00 0x6b 0x04>;
		iommus = <0x3a>;
		reg = <0x00 0xff870000 0x00 0x400>;
		reset-names = "video_a", "video_h";
		resets = <0x02 0x296 0x02 0x297>;
		rockchip,disable-auto-freq;
		rockchip,normal-rates = <0x1443fd00 0x00>;
		rockchip,resetgroup-node = <0x04>;
		rockchip,srv = <0x30>;
		rockchip,taskqueue-node = <0x04>;
		status = "okay";
	};

	mailbox@ff630000 {
		#mbox-cells = <0x01>;
		clock-names = "pclk_mailbox";
		clocks = <0x02 0x20a>;
		compatible = "rockchip,rk3528-mailbox", "rockchip,rk3368-mailbox";
		interrupts = <0x00 0x3c 0x04>;
		reg = <0x00 0xff630000 0x00 0x200>;
		status = "disabled";
	};

	mmc@ffbf0000 {
		assigned-clock-rates = <0xbebc200 0x16e3600 0xbebc200>;
		assigned-clocks = <0x02 0xa6 0x02 0xa7 0x02 0xa3>;
		bus-width = <0x08>;
		clock-names = "core", "bus", "axi", "block", "timer";
		clocks = <0x02 0xa3 0x02 0xa4 0x02 0xa5 0x02 0xa6 0x02 0xa7>;
		compatible = "rockchip,rk3528-dwcmshc";
		fixed-emmc-driver-type = <0x04>;
		interrupts = <0x00 0x88 0x04>;
		max-frequency = <0xbebc200>;
		mmc-hs400-1_8v;
		mmc-hs400-enhanced-strobe;
		non-removable;
		reg = <0x00 0xffbf0000 0x00 0x10000>;
		reset-names = "core", "bus", "axi", "block", "timer";
		resets = <0x02 0x19f 0x02 0x1a0 0x02 0x1a1 0x02 0x1a2 0x02 0x1a3>;
		status = "okay";
		supports-emmc;
	};

	mmc@ffc10000 {
		clock-names = "biu", "ciu", "ciu-drive", "ciu-sample";
		clocks = <0x02 0xf1 0x02 0xf0 0x7f 0x03 0x7f 0x04>;
		compatible = "rockchip,rk3528-dw-mshc", "rockchip,rk3288-dw-mshc";
		fifo-depth = <0x100>;
		interrupts = <0x00 0x89 0x04>;
		max-frequency = <0x8f0d180>;
		reg = <0x00 0xffc10000 0x00 0x4000>;
		reset-names = "reset";
		resets = <0x02 0x202>;
		rockchip,use-v2-tuning;
		status = "disabled";
	};

	mmc@ffc20000 {
		clock-names = "biu", "ciu", "ciu-drive", "ciu-sample";
		clocks = <0x02 0xf5 0x02 0xf4 0x7f 0x05 0x7f 0x06>;
		compatible = "rockchip,rk3528-dw-mshc", "rockchip,rk3288-dw-mshc";
		fifo-depth = <0x100>;
		interrupts = <0x00 0x8a 0x04>;
		max-frequency = <0x8f0d180>;
		reg = <0x00 0xffc20000 0x00 0x4000>;
		reset-names = "reset";
		resets = <0x02 0x204>;
		rockchip,use-v2-tuning;
		status = "disabled";
	};

	mmc@ffc30000 {
		clock-names = "biu", "ciu", "ciu-drive", "ciu-sample";
		clocks = <0x02 0x198 0x02 0x197 0x7f 0x01 0x7f 0x02>;
		compatible = "rockchip,rk3528-dw-mshc", "rockchip,rk3288-dw-mshc";
		fifo-depth = <0x100>;
		interrupts = <0x00 0x85 0x04>;
		max-frequency = <0x8f0d180>;
		reg = <0x00 0xffc30000 0x00 0x4000>;
		reset-names = "reset";
		resets = <0x02 0x2a9>;
		rockchip,use-v2-tuning;
		status = "disabled";
	};

	mpp-srv {
		compatible = "rockchip,mpp-service";
		phandle = <0x30>;
		rockchip,resetgroup-count = <0x05>;
		rockchip,taskqueue-count = <0x05>;
		status = "okay";
	};

	otp@ffce0000 {
		#address-cells = <0x01>;
		#size-cells = <0x01>;
		clock-names = "usr", "sbpi", "apb";
		clocks = <0x02 0x19d 0x02 0x19c 0x02 0x19b>;
		compatible = "rockchip,rk3528-otp";
		reg = <0x00 0xffce0000 0x00 0x4000>;
		reset-names = "usr", "sbpi", "apb";
		resets = <0x02 0x2ad 0x02 0x2ac 0x02 0x2ab>;

		cpu-code@2 {
			phandle = <0x12>;
			reg = <0x02 0x02>;
		};

		cpu-leakage@1a {
			phandle = <0x0c>;
			reg = <0x1a 0x01>;
		};

		cpu-mbist-vmin@9 {
			bits = <0x00 0x03>;
			phandle = <0x0e>;
			reg = <0x09 0x01>;
		};

		cpu-opp-info@32 {
			phandle = <0x0d>;
			reg = <0x32 0x06>;
		};

		cpu-tsadc-trim-h@45 {
			phandle = <0x58>;
			reg = <0x45 0x01>;
		};

		cpu-tsadc-trim-l@44 {
			phandle = <0x57>;
			reg = <0x44 0x01>;
		};

		cpu-version@8 {
			bits = <0x03 0x03>;
			phandle = <0x11>;
			reg = <0x08 0x01>;
		};

		dmc-opp-info@3e {
			phandle = <0x1c>;
			reg = <0x3e 0x06>;
		};

		gpu-leakage@1c {
			phandle = <0x2b>;
			reg = <0x1c 0x01>;
		};

		gpu-mbist-vmin@9 {
			bits = <0x03 0x02>;
			phandle = <0x2d>;
			reg = <0x09 0x01>;
		};

		gpu-opp-info@38 {
			phandle = <0x2c>;
			reg = <0x38 0x06>;
		};

		id@a {
			phandle = <0x10>;
			reg = <0x0a 0x10>;
		};

		log-leakage@1b {
			phandle = <0x1b>;
			reg = <0x1b 0x01>;
		};

		logic-mbist-vmin@9 {
			bits = <0x05 0x02>;
			phandle = <0x1d>;
			reg = <0x09 0x01>;
		};

		macphy-bgs@2d {
			phandle = <0x73>;
			reg = <0x2d 0x01>;
		};

		macphy-txlevel@2e {
			phandle = <0x74>;
			reg = <0x2e 0x02>;
		};

		test-version@29 {
			phandle = <0x3c>;
			reg = <0x29 0x01>;
		};

		vdac-out-current@30 {
			phandle = <0x3b>;
			reg = <0x30 0x01>;
		};
	};

	pcie@fe4f0000 {
		#address-cells = <0x03>;
		#interrupt-cells = <0x01>;
		#size-cells = <0x02>;
		bus-range = <0x00 0xff>;
		clock-names = "aclk", "hclk_slv", "hclk_dbi", "pclk_cru", "aux", "pclk", "pipe";
		clocks = <0x02 0xd9 0x02 0xda 0x02 0xdb 0x02 0x9e 0x02 0xd8 0x02 0xd7 0x02 0xdc>;
		compatible = "rockchip,rk3528-pcie", "snps,dw-pcie";
		device_type = "pci";
		interrupt-map = <0x00 0x00 0x00 0x01 0x22 0x00 0x00 0x00 0x00 0x02 0x22 0x01 0x00 0x00 0x00 0x03 0x22 0x02 0x00 0x00 0x00 0x04 0x22 0x03>;
		interrupt-map-mask = <0x00 0x00 0x00 0x07>;
		interrupt-names = "msi", "pmc", "sys", "legacy", "msg", "err";
		interrupts = <0x00 0x9e 0x04 0x00 0x9d 0x04 0x00 0x9c 0x04 0x00 0x9b 0x04 0x00 0x9a 0x04 0x00 0x99 0x04>;
		linux,pci-domain = <0x00>;
		max-link-speed = <0x02>;
		num-ib-windows = <0x08>;
		num-lanes = <0x01>;
		num-ob-windows = <0x08>;
		num-viewport = <0x04>;
		phy-names = "pcie-phy";
		phys = <0x23 0x02>;
		ranges = <0x81000000 0x00 0xfc100000 0x00 0xfc100000 0x00 0x100000 0x82000000 0x00 0xfc200000 0x00 0xfc200000 0x00 0x1e00000 0xc3000000 0x01 0x00 0x01 0x00 0x00 0x40000000>;
		reg = <0x00 0xfe4f0000 0x00 0x10000 0x00 0xfe000000 0x00 0x400000 0x00 0xfc000000 0x00 0x100000>;
		reg-names = "pcie-apb", "pcie-dbi", "config";
		reset-names = "pcie", "periph", "preset_cru";
		resets = <0x02 0x1e3 0x02 0x1e1 0x02 0x19b>;
		status = "okay";

		legacy-interrupt-controller {
			#address-cells = <0x00>;
			#interrupt-cells = <0x01>;
			interrupt-controller;
			interrupt-parent = <0x01>;
			interrupts = <0x00 0x9b 0x01>;
			phandle = <0x22>;
		};
	};

	pdm-mic-array {
		compatible = "simple-audio-card";
		simple-audio-card,name = "rockchip,pdm-mic-array";
		status = "disabled";

		simple-audio-card,codec {
			sound-dai = <0x94>;
		};

		simple-audio-card,cpu {
			sound-dai = <0x93>;
		};
	};

	pdm@ffbb0000 {
		#sound-dai-cells = <0x00>;
		clock-names = "pdm_clk", "pdm_hclk";
		clocks = <0x02 0x137 0x02 0x136>;
		compatible = "rockchip,rk3528-pdm", "rockchip,rk3568-pdm";
		dma-names = "rx";
		dmas = <0x40 0x06>;
		phandle = <0x93>;
		pinctrl-0 = <0x68 0x69 0x6a 0x6b 0x6c 0x6d>;
		pinctrl-names = "default";
		reg = <0x00 0xffbb0000 0x00 0x1000>;
		status = "disabled";
	};

	phy@ffdc0000 {
		#phy-cells = <0x01>;
		assigned-clock-rates = <0x5f5e100>;
		assigned-clocks = <0x02 0x91>;
		clock-names = "refclk", "apbclk", "pipe_clk";
		clocks = <0x02 0x91 0x02 0xdc 0x02 0xdd>;
		compatible = "rockchip,rk3528-naneng-combphy";
		phandle = <0x23>;
		reg = <0x00 0xffdc0000 0x00 0x10000>;
		reset-names = "combphy-apb", "combphy";
		resets = <0x02 0x1e6 0x02 0x1e2>;
		rockchip,pipe-grf = <0x0f>;
		rockchip,pipe-phy-grf = <0x0f>;
		status = "okay";
	};

	pinctrl {
		#address-cells = <0x02>;
		#size-cells = <0x02>;
		compatible = "rockchip,rk3528-pinctrl";
		phandle = <0x83>;
		ranges;
		rockchip,grf = <0x82>;

		gpio@ff610000 {
			#gpio-cells = <0x02>;
			#interrupt-cells = <0x02>;
			clocks = <0x02 0x1fd 0x02 0x1fe>;
			compatible = "rockchip,gpio-bank";
			gpio-controller;
			gpio-ranges = <0x83 0x00 0x00 0x20>;
			interrupt-controller;
			interrupts = <0x00 0x47 0x04>;
			phandle = <0x3f>;
			reg = <0x00 0xff610000 0x00 0x200>;
		};

		gpio@ffaf0000 {
			#gpio-cells = <0x02>;
			#interrupt-cells = <0x02>;
			clocks = <0x02 0xa8 0x02 0xa9>;
			compatible = "rockchip,gpio-bank";
			gpio-controller;
			gpio-ranges = <0x83 0x00 0x20 0x20>;
			interrupt-controller;
			interrupts = <0x00 0x49 0x04>;
			phandle = <0x9d>;
			reg = <0x00 0xffaf0000 0x00 0x200>;
		};

		gpio@ffb00000 {
			#gpio-cells = <0x02>;
			#interrupt-cells = <0x02>;
			clocks = <0x02 0x194 0x02 0x195>;
			compatible = "rockchip,gpio-bank";
			gpio-controller;
			gpio-ranges = <0x83 0x00 0x40 0x20>;
			interrupt-controller;
			interrupts = <0x00 0x4b 0x04>;
			reg = <0x00 0xffb00000 0x00 0x200>;
		};

		gpio@ffb10000 {
			#gpio-cells = <0x02>;
			#interrupt-cells = <0x02>;
			clocks = <0x02 0xba 0x02 0xbb>;
			compatible = "rockchip,gpio-bank";
			gpio-controller;
			gpio-ranges = <0x83 0x00 0x60 0x20>;
			interrupt-controller;
			interrupts = <0x00 0x4c 0x04>;
			reg = <0x00 0xffb10000 0x00 0x200>;
		};

		gpio@ffb20000 {
			#gpio-cells = <0x02>;
			#interrupt-cells = <0x02>;
			clocks = <0x02 0x12c 0x02 0x12d>;
			compatible = "rockchip,gpio-bank";
			gpio-controller;
			gpio-ranges = <0x83 0x00 0x80 0x20>;
			interrupt-controller;
			interrupts = <0x00 0x4e 0x04>;
			phandle = <0x78>;
			reg = <0x00 0xffb20000 0x00 0x200>;
		};

		hdmi {

			hdmi-pins {
				phandle = <0x3d>;
				rockchip,pins = <0x00 0x03 0x01 0x84 0x00 0x04 0x01 0x84 0x00 0x05 0x01 0x84>;
			};
		};

		i2c0 {

			i2c0m0-xfer {
				phandle = <0x47>;
				rockchip,pins = <0x04 0x14 0x02 0x88 0x04 0x13 0x02 0x88>;
			};
		};

		i2c1 {

			i2c1m0-xfer {
				phandle = <0x48>;
				rockchip,pins = <0x04 0x03 0x02 0x88 0x04 0x02 0x02 0x88>;
			};
		};

		i2c2 {

			i2c2m0-xfer {
				phandle = <0x49>;
				rockchip,pins = <0x00 0x04 0x02 0x88 0x00 0x05 0x02 0x88>;
			};
		};

		i2c3 {

			i2c3m0-xfer {
				phandle = <0x4a>;
				rockchip,pins = <0x01 0x00 0x02 0x88 0x01 0x01 0x02 0x88>;
			};
		};

		i2c4 {

			i2c4-xfer {
				phandle = <0x4b>;
				rockchip,pins = <0x02 0x00 0x04 0x88 0x02 0x01 0x04 0x88>;
			};
		};

		i2c5 {

			i2c5m0-xfer {
				phandle = <0x4c>;
				rockchip,pins = <0x01 0x0a 0x03 0x88 0x01 0x0b 0x03 0x88>;
			};
		};

		i2c6 {

			i2c6m0-xfer {
				phandle = <0x4d>;
				rockchip,pins = <0x03 0x0a 0x05 0x88 0x03 0x0b 0x05 0x88>;
			};
		};

		i2c7 {

			i2c7-xfer {
				phandle = <0x4e>;
				rockchip,pins = <0x02 0x05 0x04 0x88 0x02 0x06 0x04 0x88>;
			};
		};

		i2s0 {

			i2s0m0-lrck {
				phandle = <0x5a>;
				rockchip,pins = <0x03 0x0e 0x01 0x88>;
			};

			i2s0m0-sclk {
				phandle = <0x5b>;
				rockchip,pins = <0x03 0x0d 0x01 0x88>;
			};

			i2s0m0-sdi {
				phandle = <0x5c>;
				rockchip,pins = <0x03 0x0f 0x01 0x84>;
			};

			i2s0m0-sdo {
				phandle = <0x5d>;
				rockchip,pins = <0x03 0x10 0x01 0x84>;
			};
		};

		i2s1 {

			i2s1-lrck {
				phandle = <0x5f>;
				rockchip,pins = <0x04 0x06 0x01 0x88>;
			};

			i2s1-sclk {
				phandle = <0x5e>;
				rockchip,pins = <0x04 0x05 0x01 0x88>;
			};

			i2s1-sdi0 {
				phandle = <0x60>;
				rockchip,pins = <0x04 0x0c 0x01 0x84>;
			};

			i2s1-sdi1 {
				phandle = <0x61>;
				rockchip,pins = <0x04 0x0b 0x01 0x84>;
			};

			i2s1-sdi2 {
				phandle = <0x62>;
				rockchip,pins = <0x04 0x03 0x01 0x84>;
			};

			i2s1-sdi3 {
				phandle = <0x63>;
				rockchip,pins = <0x04 0x02 0x01 0x84>;
			};

			i2s1-sdo0 {
				phandle = <0x64>;
				rockchip,pins = <0x04 0x07 0x01 0x84>;
			};

			i2s1-sdo1 {
				phandle = <0x65>;
				rockchip,pins = <0x04 0x08 0x01 0x84>;
			};

			i2s1-sdo2 {
				phandle = <0x66>;
				rockchip,pins = <0x04 0x09 0x01 0x84>;
			};

			i2s1-sdo3 {
				phandle = <0x67>;
				rockchip,pins = <0x04 0x0a 0x01 0x84>;
			};
		};

		pcfg-output-low-pull-down {
			bias-pull-down;
			output-low;
			phandle = <0x87>;
		};

		pcfg-pull-down {
			bias-pull-down;
			phandle = <0x8b>;
		};

		pcfg-pull-none {
			bias-disable;
			phandle = <0x84>;
		};

		pcfg-pull-none-drv-level-0 {
			bias-disable;
			drive-strength = <0x00>;
			phandle = <0x89>;
		};

		pcfg-pull-none-drv-level-2 {
			bias-disable;
			drive-strength = <0x02>;
			phandle = <0x86>;
		};

		pcfg-pull-none-smt {
			bias-disable;
			input-schmitt-enable;
			phandle = <0x88>;
		};

		pcfg-pull-up {
			bias-pull-up;
			phandle = <0x8a>;
		};

		pcfg-pull-up-drv-level-2 {
			bias-pull-up;
			drive-strength = <0x02>;
			phandle = <0x85>;
		};

		pdm {

			pdm-clk0 {
				phandle = <0x68>;
				rockchip,pins = <0x04 0x0d 0x03 0x84>;
			};

			pdm-clk1 {
				phandle = <0x69>;
				rockchip,pins = <0x04 0x04 0x03 0x84>;
			};

			pdm-sdi0 {
				phandle = <0x6a>;
				rockchip,pins = <0x04 0x0a 0x03 0x84>;
			};

			pdm-sdi1 {
				phandle = <0x6b>;
				rockchip,pins = <0x04 0x09 0x03 0x84>;
			};

			pdm-sdi2 {
				phandle = <0x6c>;
				rockchip,pins = <0x04 0x0b 0x03 0x84>;
			};

			pdm-sdi3 {
				phandle = <0x6d>;
				rockchip,pins = <0x04 0x11 0x03 0x84>;
			};
		};

		peic {

			peic-vcc-en {
				phandle = <0x9c>;
				rockchip,pins = <0x01 0x02 0x00 0x84>;
			};
		};

		pwm0 {

			pwm0m0-pins {
				phandle = <0x4f>;
				rockchip,pins = <0x04 0x13 0x01 0x89>;
			};
		};

		pwm1 {

			pwm1m0-pins {
				phandle = <0x50>;
				rockchip,pins = <0x04 0x14 0x01 0x89>;
			};
		};

		pwm2 {

			pwm2m0-pins {
				phandle = <0x51>;
				rockchip,pins = <0x04 0x15 0x01 0x89>;
			};
		};

		pwm3 {

			pwm3m0-pins {
				phandle = <0x52>;
				rockchip,pins = <0x04 0x16 0x01 0x89>;
			};
		};

		pwm4 {

			pwm4m0-pins {
				phandle = <0x53>;
				rockchip,pins = <0x04 0x0f 0x01 0x89>;
			};
		};

		pwm5 {

			pwm5m0-pins {
				phandle = <0x54>;
				rockchip,pins = <0x04 0x10 0x01 0x89>;
			};
		};

		pwm6 {

			pwm6m0-pins {
				phandle = <0x55>;
				rockchip,pins = <0x04 0x11 0x01 0x89>;
			};
		};

		pwm7 {

			pwm7m0-pins {
				phandle = <0x56>;
				rockchip,pins = <0x04 0x12 0x01 0x89>;
			};
		};

		rgmii {

			rgmii-miim {
				phandle = <0x79>;
				rockchip,pins = <0x03 0x0e 0x02 0x86 0x03 0x0f 0x02 0x86>;
			};

			rgmii-rgmii_bus {
				phandle = <0x7d>;
				rockchip,pins = <0x03 0x07 0x02 0x84 0x03 0x06 0x02 0x84 0x03 0x09 0x02 0x86 0x03 0x08 0x02 0x86>;
			};

			rgmii-rgmii_clk {
				phandle = <0x7c>;
				rockchip,pins = <0x03 0x05 0x02 0x84 0x03 0x04 0x02 0x86>;
			};

			rgmii-rx_bus2 {
				phandle = <0x7b>;
				rockchip,pins = <0x03 0x03 0x02 0x84 0x03 0x02 0x02 0x84 0x03 0x12 0x02 0x84>;
			};

			rgmii-tx_bus2 {
				phandle = <0x7a>;
				rockchip,pins = <0x03 0x01 0x02 0x86 0x03 0x00 0x02 0x86 0x03 0x10 0x02 0x84>;
			};
		};

		spdif {

			spdifm0-pins {
				phandle = <0x6e>;
				rockchip,pins = <0x04 0x00 0x01 0x84>;
			};
		};

		spi0 {

			spi0-csn0 {
				phandle = <0x41>;
				rockchip,pins = <0x04 0x0e 0x02 0x86>;
			};

			spi0-csn1 {
				phandle = <0x42>;
				rockchip,pins = <0x04 0x11 0x02 0x86>;
			};

			spi0-pins {
				phandle = <0x43>;
				rockchip,pins = <0x04 0x0c 0x02 0x86 0x04 0x0b 0x02 0x86 0x04 0x0a 0x02 0x86>;
			};
		};

		spi1 {

			spi1-csn0 {
				phandle = <0x44>;
				rockchip,pins = <0x01 0x11 0x01 0x86>;
			};

			spi1-csn1 {
				phandle = <0x45>;
				rockchip,pins = <0x01 0x12 0x01 0x86>;
			};

			spi1-pins {
				phandle = <0x46>;
				rockchip,pins = <0x01 0x0e 0x02 0x86 0x01 0x10 0x02 0x86 0x01 0x0f 0x02 0x86>;
			};
		};

		uart0 {

			uart0m0-xfer {
				phandle = <0x9f>;
				rockchip,pins = <0x04 0x17 0x01 0x8a 0x04 0x18 0x01 0x8a>;
			};
		};

		usb {

			vcc5v0-host-en {
				phandle = <0x99>;
				rockchip,pins = <0x04 0x0c 0x00 0x84>;
			};
		};

		wireless-wlan {

			wifi-enable-h {
				rockchip,pins = <0x01 0x06 0x00 0x84>;
			};

			wifi-host-wake-irq {
				rockchip,pins = <0x01 0x07 0x00 0x8b>;
			};
		};
	};

	power-management@ff600000 {
		compatible = "rockchip,rk3528-pmu", "syscon", "simple-mfd";
		reg = <0x00 0xff600000 0x00 0x2000>;

		power-controller {
			#address-cells = <0x01>;
			#power-domain-cells = <0x01>;
			#size-cells = <0x00>;
			compatible = "rockchip,rk3528-power-controller";
			phandle = <0x29>;
			status = "okay";

			pd_gpu@4 {
				clocks = <0x02 0x113 0x02 0x10e>;
				pm_qos = <0x27 0x28>;
				reg = <0x04>;
			};

			pd_rkvdec@5 {
				reg = <0x05>;
			};

			pd_rkvenc@6 {
				reg = <0x06>;
			};

			pd_vo@7 {
				reg = <0x07>;
			};

			pd_vpu@8 {
				reg = <0x08>;
			};
		};
	};

	psci {
		compatible = "arm,psci-1.0";
		method = "smc";
	};

	pwm@ffa90000 {
		#pwm-cells = <0x03>;
		clock-names = "pwm", "pclk";
		clocks = <0x02 0x7f 0x02 0x7e>;
		compatible = "rockchip,rk3528-pwm", "rockchip,rk3328-pwm";
		interrupts = <0x00 0x35 0x04>;
		pinctrl-0 = <0x4f>;
		pinctrl-names = "active";
		reg = <0x00 0xffa90000 0x00 0x10>;
		status = "disabled";
	};

	pwm@ffa90010 {
		#pwm-cells = <0x03>;
		clock-names = "pwm", "pclk";
		clocks = <0x02 0x7f 0x02 0x7e>;
		compatible = "rockchip,rk3528-pwm", "rockchip,rk3328-pwm";
		interrupts = <0x00 0x35 0x04>;
		phandle = <0x9b>;
		pinctrl-0 = <0x50>;
		pinctrl-names = "active";
		reg = <0x00 0xffa90010 0x00 0x10>;
		status = "okay";
	};

	pwm@ffa90020 {
		#pwm-cells = <0x03>;
		clock-names = "pwm", "pclk";
		clocks = <0x02 0x7f 0x02 0x7e>;
		compatible = "rockchip,rk3528-pwm", "rockchip,rk3328-pwm";
		interrupts = <0x00 0x35 0x04>;
		phandle = <0x9a>;
		pinctrl-0 = <0x51>;
		pinctrl-names = "active";
		reg = <0x00 0xffa90020 0x00 0x10>;
		status = "okay";
	};

	pwm@ffa90030 {
		#pwm-cells = <0x03>;
		clock-names = "pwm", "pclk";
		clocks = <0x02 0x7f 0x02 0x7e>;
		compatible = "rockchip,remotectl-pwm";
		handle_cpu_id = <0x01>;
		interrupts = <0x00 0x35 0x04 0x00 0x36 0x04>;
		pinctrl-0 = <0x52>;
		pinctrl-names = "default";
		reg = <0x00 0xffa90030 0x00 0x10>;
		remote_pwm_id = <0x03>;
		remote_support_psci = <0x00>;
		status = "okay";
	};

	pwm@ffa98000 {
		#pwm-cells = <0x03>;
		clock-names = "pwm", "pclk";
		clocks = <0x02 0x82 0x02 0x81>;
		compatible = "rockchip,rk3528-pwm", "rockchip,rk3328-pwm";
		interrupts = <0x00 0x37 0x04>;
		pinctrl-0 = <0x53>;
		pinctrl-names = "active";
		reg = <0x00 0xffa98000 0x00 0x10>;
		status = "disabled";
	};

	pwm@ffa98010 {
		#pwm-cells = <0x03>;
		clock-names = "pwm", "pclk";
		clocks = <0x02 0x82 0x02 0x81>;
		compatible = "rockchip,rk3528-pwm", "rockchip,rk3328-pwm";
		interrupts = <0x00 0x37 0x04>;
		pinctrl-0 = <0x54>;
		pinctrl-names = "active";
		reg = <0x00 0xffa98010 0x00 0x10>;
		status = "disabled";
	};

	pwm@ffa98020 {
		#pwm-cells = <0x03>;
		clock-names = "pwm", "pclk";
		clocks = <0x02 0x82 0x02 0x81>;
		compatible = "rockchip,rk3528-pwm", "rockchip,rk3328-pwm";
		interrupts = <0x00 0x37 0x04>;
		pinctrl-0 = <0x55>;
		pinctrl-names = "active";
		reg = <0x00 0xffa98020 0x00 0x10>;
		status = "disabled";
	};

	pwm@ffa98030 {
		#pwm-cells = <0x03>;
		clock-names = "pwm", "pclk";
		clocks = <0x02 0x82 0x02 0x81>;
		compatible = "rockchip,rk3528-pwm", "rockchip,rk3328-pwm";
		interrupts = <0x00 0x37 0x04 0x00 0x38 0x04>;
		pinctrl-0 = <0x56>;
		pinctrl-names = "active";
		reg = <0x00 0xffa98030 0x00 0x10>;
		status = "disabled";
	};

	qos@ff200000 {
		compatible = "syscon";
		reg = <0x00 0xff200000 0x00 0x20>;
	};

	qos@ff200080 {
		compatible = "syscon";
		reg = <0x00 0xff200080 0x00 0x20>;
	};

	qos@ff200100 {
		compatible = "syscon";
		reg = <0x00 0xff200100 0x00 0x20>;
	};

	qos@ff200200 {
		compatible = "syscon";
		reg = <0x00 0xff200200 0x00 0x20>;
	};

	qos@ff200280 {
		compatible = "syscon";
		reg = <0x00 0xff200280 0x00 0x20>;
	};

	qos@ff200300 {
		compatible = "syscon";
		reg = <0x00 0xff200300 0x00 0x20>;
	};

	qos@ff200380 {
		compatible = "syscon";
		reg = <0x00 0xff200380 0x00 0x20>;
	};

	qos@ff210000 {
		compatible = "syscon";
		reg = <0x00 0xff210000 0x00 0x20>;
	};

	qos@ff210080 {
		compatible = "syscon";
		reg = <0x00 0xff210080 0x00 0x20>;
	};

	qos@ff220000 {
		compatible = "syscon";
		phandle = <0x27>;
		reg = <0x00 0xff220000 0x00 0x20>;
	};

	qos@ff220080 {
		compatible = "syscon";
		phandle = <0x28>;
		reg = <0x00 0xff220080 0x00 0x20>;
	};

	qos@ff240000 {
		compatible = "syscon";
		reg = <0x00 0xff240000 0x00 0x20>;
	};

	qos@ff250000 {
		compatible = "syscon";
		reg = <0x00 0xff250000 0x00 0x20>;
	};

	qos@ff260000 {
		compatible = "syscon";
		reg = <0x00 0xff260000 0x00 0x20>;
	};

	qos@ff270000 {
		compatible = "syscon";
		reg = <0x00 0xff270000 0x00 0x20>;
	};

	qos@ff270080 {
		compatible = "syscon";
		reg = <0x00 0xff270080 0x00 0x20>;
	};

	qos@ff270100 {
		compatible = "syscon";
		reg = <0x00 0xff270100 0x00 0x20>;
	};

	qos@ff270200 {
		compatible = "syscon";
		reg = <0x00 0xff270200 0x00 0x20>;
	};

	qos@ff270280 {
		compatible = "syscon";
		reg = <0x00 0xff270280 0x00 0x20>;
	};

	qos@ff270300 {
		compatible = "syscon";
		reg = <0x00 0xff270300 0x00 0x20>;
	};

	qos@ff270380 {
		compatible = "syscon";
		reg = <0x00 0xff270380 0x00 0x20>;
	};

	qos@ff270480 {
		compatible = "syscon";
		reg = <0x00 0xff270480 0x00 0x20>;
	};

	qos@ff270500 {
		compatible = "syscon";
		reg = <0x00 0xff270500 0x00 0x20>;
	};

	qos@ff280000 {
		compatible = "syscon";
		reg = <0x00 0xff280000 0x00 0x20>;
	};

	qos@ff280080 {
		compatible = "syscon";
		reg = <0x00 0xff280080 0x00 0x20>;
	};

	qos@ff280100 {
		compatible = "syscon";
		reg = <0x00 0xff280100 0x00 0x20>;
	};

	qos@ff280180 {
		compatible = "syscon";
		reg = <0x00 0xff280180 0x00 0x20>;
	};

	qos@ff280200 {
		compatible = "syscon";
		reg = <0x00 0xff280200 0x00 0x20>;
	};

	qos@ff280280 {
		compatible = "syscon";
		reg = <0x00 0xff280280 0x00 0x20>;
	};

	qos@ff280300 {
		compatible = "syscon";
		reg = <0x00 0xff280300 0x00 0x20>;
	};

	qos@ff280380 {
		compatible = "syscon";
		reg = <0x00 0xff280380 0x00 0x20>;
	};

	qos@ff280400 {
		compatible = "syscon";
		reg = <0x00 0xff280400 0x00 0x20>;
	};

	reserved-memory {
		#address-cells = <0x02>;
		#size-cells = <0x02>;
		ranges;

		drm-cubic-lut@0 {
			compatible = "rockchip,drm-cubic-lut";
			phandle = <0x15>;
			reg = <0x00 0x00 0x00 0x00>;
		};

		drm-logo@0 {
			compatible = "rockchip,drm-logo";
			phandle = <0x14>;
			reg = <0x00 0x00 0x00 0x00>;
		};

		ramoops@110000 {
			boot-log-count = <0x01>;
			boot-log-size = <0x8000>;
			compatible = "ramoops";
			console-size = <0x80000>;
			ftrace-size = <0x00>;
			pmsg-size = <0x30000>;
			record-size = <0x14000>;
			reg = <0x00 0x110000 0x00 0xe0000>;
		};
	};

	rga@ff850000 {
		clock-names = "aclk_rga2", "hclk_rga2", "clk_rga2";
		clocks = <0x02 0x14b 0x02 0x14a 0x02 0x14c>;
		compatible = "rockchip,rga2_core0";
		interrupt-names = "rga2_irq";
		interrupts = <0x00 0x69 0x04>;
		iommus = <0x38>;
		reg = <0x00 0xff850000 0x00 0x1000>;
		rockchip,grf = <0x0f>;
		rockchip,grf-offset = <0x600e0>;
		rockchip,grf-values = <0xff10000 0xff10ff1>;
		status = "okay";
	};

	rkvdec@ff740100 {
		assigned-clock-rates = <0x1443fd00 0x23c34600>;
		assigned-clocks = <0x02 0x1b7 0x02 0x1b9>;
		clock-names = "aclk_vcodec", "hclk_vcodec", "clk_hevc_cabac";
		clocks = <0x02 0x1b7 0x02 0x1b8 0x02 0x1b9>;
		compatible = "rockchip,rkv-decoder-rk3528", "rockchip,rkv-decoder-v2";
		interrupt-names = "irq_dec";
		interrupts = <0x00 0x5e 0x04>;
		iommus = <0x2f>;
		reg = <0x00 0xff740100 0x00 0x400 0x00 0xff740000 0x00 0x100>;
		reg-names = "regs", "link";
		reset-names = "video_a", "video_h", "video_hevc_cabac";
		resets = <0x02 0x2c8 0x02 0x2c9 0x02 0x2cb>;
		rockchip,normal-rates = <0x1443fd00 0x00 0x23c34600>;
		rockchip,rcb-iova = <0x10000000 0x10000>;
		rockchip,rcb-min-width = <0x200>;
		rockchip,resetgroup-node = <0x00>;
		rockchip,sram = <0x31>;
		rockchip,srv = <0x30>;
		rockchip,task-capacity = <0x10>;
		rockchip,taskqueue-node = <0x00>;
		status = "okay";
	};

	rkvenc@ff780000 {
		assigned-clock-rates = <0x11e1a300 0x11e1a300>;
		assigned-clocks = <0x02 0x120 0x02 0x121>;
		clock-names = "aclk_vcodec", "hclk_vcodec", "clk_core";
		clocks = <0x02 0x120 0x02 0x11f 0x02 0x121>;
		compatible = "rockchip,rkv-encoder-rk3528", "rockchip,rkv-encoder-v2";
		interrupt-names = "irq_rkvenc";
		interrupts = <0x00 0x61 0x04>;
		iommus = <0x32>;
		reg = <0x00 0xff780000 0x00 0x6000>;
		reset-names = "video_a", "video_h", "video_core";
		resets = <0x02 0x247 0x02 0x246 0x02 0x248>;
		rockchip,grf = <0x0f>;
		rockchip,grf-mem-offset = <0x20010>;
		rockchip,grf-mem-values = <0x21 0xffff0021>;
		rockchip,normal-rates = <0x11e1a300 0x00 0x11e1a300>;
		rockchip,resetgroup-node = <0x01>;
		rockchip,srv = <0x30>;
		rockchip,taskqueue-node = <0x01>;
		status = "okay";
	};

	rkvtunnel {
		compatible = "rockchip,video-tunnel";
		status = "disabled";
	};

	rng@ffc50000 {
		clock-names = "hclk_trng";
		clocks = <0x07 0x20>;
		compatible = "rockchip,rkrng";
		interrupts = <0x00 0x17 0x04>;
		reg = <0x00 0xffc50000 0x00 0x200>;
		reset-names = "reset";
		resets = <0x02 0xa3>;
		status = "okay";
	};

	rockchip-suspend {
		compatible = "rockchip,pm-rk3528";
		rockchip,pwm-regulator-config = <0x02>;
		rockchip,sleep-debug-en = <0x01>;
		rockchip,sleep-mode-config = <0x01>;
		rockchip,virtual-poweroff = <0x01>;
		rockchip,wakeup-config = <0x11>;
		status = "okay";
	};

	rockchip-system-monitor {
		compatible = "rockchip,system-monitor";
		rockchip,offline-cpu-temp = <0x19a28>;
		rockchip,polling-delay = <0xc8>;
		rockchip,temp-hysteresis = <0x1388>;
		rockchip,temp-offline-cpus = "2-3";
		rockchip,thermal-zone = "soc-thermal";
	};

	rtl8367b {
		compatible = "realtek,rtl8367b";
		mii-bus = <0x9e>;
		phy-id = <0x1d>;
		realtek,extif = <0x07 0x01 0x00 0x01 0x01 0x01 0x01 0x01 0x01 0x02>;
	};

	sai@ffb70000 {
		#sound-dai-cells = <0x00>;
		clock-names = "mclk", "hclk";
		clocks = <0x02 0x184 0x02 0x183>;
		compatible = "rockchip,rk3528-sai", "rockchip,sai-v1";
		dma-names = "tx";
		dmas = <0x40 0x05>;
		interrupts = <0x00 0x80 0x04>;
		phandle = <0x91>;
		reg = <0x00 0xffb70000 0x00 0x1000>;
		reset-names = "m", "h";
		resets = <0x02 0x2a2 0x02 0x2a1>;
		status = "okay";
	};

	sai@ffb80000 {
		#sound-dai-cells = <0x00>;
		clock-names = "mclk", "hclk";
		clocks = <0x02 0xaf 0x02 0xae>;
		compatible = "rockchip,rk3528-sai", "rockchip,sai-v1";
		dma-names = "tx", "rx";
		dmas = <0x40 0x01 0x40 0x00>;
		interrupts = <0x00 0x7d 0x04>;
		phandle = <0x8f>;
		pinctrl-0 = <0x5a 0x5b 0x5c 0x5d>;
		pinctrl-names = "default";
		reg = <0x00 0xffb80000 0x00 0x1000>;
		reset-names = "m", "h";
		resets = <0x02 0x1aa 0x02 0x1a9>;
		status = "disabled";
	};

	sai@ffb90000 {
		#sound-dai-cells = <0x00>;
		clock-names = "mclk", "hclk";
		clocks = <0x02 0xb1 0x02 0xb0>;
		compatible = "rockchip,rk3528-sai", "rockchip,sai-v1";
		dma-names = "tx";
		dmas = <0x40 0x04>;
		interrupts = <0x00 0x7f 0x04>;
		phandle = <0x8c>;
		reg = <0x00 0xffb90000 0x00 0x1000>;
		reset-names = "m", "h";
		resets = <0x02 0x1ac 0x02 0x1ab>;
		status = "okay";
	};

	sai@ffba0000 {
		#sound-dai-cells = <0x00>;
		clock-names = "mclk", "hclk";
		clocks = <0x02 0x123 0x02 0x122>;
		compatible = "rockchip,rk3528-sai", "rockchip,sai-v1";
		dma-names = "tx", "rx";
		dmas = <0x40 0x03 0x40 0x02>;
		interrupts = <0x00 0x7e 0x04>;
		pinctrl-0 = <0x5e 0x5f 0x60 0x61 0x62 0x63 0x64 0x65 0x66 0x67>;
		pinctrl-names = "default";
		reg = <0x00 0xffba0000 0x00 0x1000>;
		reset-names = "m", "h";
		resets = <0x02 0x24a 0x02 0x249>;
		status = "disabled";
	};

	saradc@ffae0000 {
		#io-channel-cells = <0x01>;
		clock-names = "saradc", "apb_pclk";
		clocks = <0x02 0x101 0x02 0x100>;
		compatible = "rockchip,rk3528-saradc";
		interrupts = <0x00 0x8c 0x04>;
		phandle = <0x8e>;
		reg = <0x00 0xffae0000 0x00 0x10000>;
		reset-names = "saradc-apb";
		resets = <0x02 0x20b>;
		status = "okay";
		vref-supply = <0x59>;
	};

	scmi-shmem@10f000 {
		compatible = "arm,scmi-shmem";
		phandle = <0x1e>;
		reg = <0x00 0x10f000 0x00 0x100>;
	};

	secure-otp {
		compatible = "rockchip,secure-otp";
		rockchip,otp-size = <0x20>;
		status = "disabled";
	};

	serial@ff9f0000 {
		clock-names = "baudclk", "apb_pclk";
		clocks = <0x02 0x15 0x02 0x75>;
		compatible = "rockchip,rk3528-uart", "snps,dw-apb-uart";
		dmas = <0x40 0x09 0x40 0x08>;
		interrupts = <0x00 0x28 0x04>;
		reg = <0x00 0xff9f0000 0x00 0x100>;
		reg-io-width = <0x04>;
		reg-shift = <0x02>;
		status = "disabled";
	};

	serial@ff9f8000 {
		clock-names = "baudclk", "apb_pclk";
		clocks = <0x02 0x18 0x02 0x13b>;
		compatible = "rockchip,rk3528-uart", "snps,dw-apb-uart";
		dmas = <0x40 0x0b 0x40 0x0a>;
		interrupts = <0x00 0x29 0x04>;
		reg = <0x00 0xff9f8000 0x00 0x100>;
		reg-io-width = <0x04>;
		reg-shift = <0x02>;
		status = "disabled";
	};

	serial@ffa00000 {
		clock-names = "baudclk", "apb_pclk";
		clocks = <0x02 0x1b 0x02 0xc0>;
		compatible = "rockchip,rk3528-uart", "snps,dw-apb-uart";
		dmas = <0x40 0x0d 0x40 0x0c>;
		interrupts = <0x00 0x2a 0x04>;
		reg = <0x00 0xffa00000 0x00 0x100>;
		reg-io-width = <0x04>;
		reg-shift = <0x02>;
		status = "disabled";
	};

	serial@ffa08000 {
		clock-names = "baudclk", "apb_pclk";
		clocks = <0x02 0x1e 0x02 0x13d>;
		compatible = "rockchip,rk3528-uart", "snps,dw-apb-uart";
		dmas = <0x40 0x0f 0x40 0x0e>;
		interrupts = <0x00 0x2b 0x04>;
		reg = <0x00 0xffa08000 0x00 0x100>;
		reg-io-width = <0x04>;
		reg-shift = <0x02>;
		status = "disabled";
	};

	serial@ffa10000 {
		clock-names = "baudclk", "apb_pclk";
		clocks = <0x02 0x21 0x02 0x1a4>;
		compatible = "rockchip,rk3528-uart", "snps,dw-apb-uart";
		dmas = <0x40 0x11 0x40 0x10>;
		interrupts = <0x00 0x2c 0x04>;
		reg = <0x00 0xffa10000 0x00 0x100>;
		reg-io-width = <0x04>;
		reg-shift = <0x02>;
		status = "disabled";
	};

	serial@ffa18000 {
		clock-names = "baudclk", "apb_pclk";
		clocks = <0x02 0x24 0x02 0xc2>;
		compatible = "rockchip,rk3528-uart", "snps,dw-apb-uart";
		dmas = <0x40 0x13 0x40 0x12>;
		interrupts = <0x00 0x2d 0x04>;
		reg = <0x00 0xffa18000 0x00 0x100>;
		reg-io-width = <0x04>;
		reg-shift = <0x02>;
		status = "disabled";
	};

	serial@ffa20000 {
		clock-names = "baudclk", "apb_pclk";
		clocks = <0x02 0x27 0x02 0xc4>;
		compatible = "rockchip,rk3528-uart", "snps,dw-apb-uart";
		dmas = <0x40 0x15 0x40 0x14>;
		interrupts = <0x00 0x2e 0x04>;
		reg = <0x00 0xffa20000 0x00 0x100>;
		reg-io-width = <0x04>;
		reg-shift = <0x02>;
		status = "disabled";
	};

	serial@ffa28000 {
		clock-names = "baudclk", "apb_pclk";
		clocks = <0x02 0x2a 0x02 0xc6>;
		compatible = "rockchip,rk3528-uart", "snps,dw-apb-uart";
		dmas = <0x40 0x17 0x40 0x16>;
		interrupts = <0x00 0x2f 0x04>;
		reg = <0x00 0xffa28000 0x00 0x100>;
		reg-io-width = <0x04>;
		reg-shift = <0x02>;
		status = "disabled";
	};

	spdif-out {
		#sound-dai-cells = <0x00>;
		compatible = "linux,spdif-dit";
		phandle = <0x96>;
		status = "okay";
	};

	spdif-sound {
		compatible = "simple-audio-card";
		simple-audio-card,mclk-fs = <0x80>;
		simple-audio-card,name = "ROCKCHIP,SPDIF";
		status = "okay";

		simple-audio-card,codec {
			sound-dai = <0x96>;
		};

		simple-audio-card,cpu {
			sound-dai = <0x95>;
		};
	};

	spdif@ffbc0000 {
		#sound-dai-cells = <0x00>;
		clock-names = "mclk", "hclk";
		clocks = <0x02 0x135 0x02 0x134>;
		compatible = "rockchip,rk3528-spdif", "rockchip,rk3568-spdif";
		dma-names = "tx";
		dmas = <0x40 0x07>;
		interrupts = <0x00 0x82 0x04>;
		phandle = <0x95>;
		pinctrl-0 = <0x6e>;
		pinctrl-names = "default";
		reg = <0x00 0xffbc0000 0x00 0x1000>;
		status = "okay";
	};

	spi@ff9c0000 {
		#address-cells = <0x01>;
		#size-cells = <0x00>;
		clock-names = "spiclk", "apb_pclk", "sclk_in";
		clocks = <0x02 0x12a 0x02 0x129 0x02 0x12b>;
		compatible = "rockchip,rk3066-spi";
		dma-names = "tx", "rx";
		dmas = <0x40 0x19 0x40 0x18>;
		interrupts = <0x00 0x83 0x04>;
		pinctrl-0 = <0x41 0x42 0x43>;
		pinctrl-names = "default";
		reg = <0x00 0xff9c0000 0x00 0x1000>;
		status = "disabled";
	};

	spi@ff9d0000 {
		#address-cells = <0x01>;
		#size-cells = <0x00>;
		clock-names = "spiclk", "apb_pclk", "sclk_in";
		clocks = <0x02 0xbe 0x02 0xbd 0x02 0xbf>;
		compatible = "rockchip,rk3066-spi";
		dma-names = "tx", "rx";
		dmas = <0x40 0x1f 0x40 0x1e>;
		interrupts = <0x00 0x84 0x04>;
		pinctrl-0 = <0x44 0x45 0x46>;
		pinctrl-names = "default";
		reg = <0x00 0xff9d0000 0x00 0x1000>;
		status = "disabled";
	};

	spi@ffc00000 {
		#address-cells = <0x01>;
		#size-cells = <0x00>;
		assigned-clock-rates = <0x5f5e100>;
		assigned-clocks = <0x02 0xa1>;
		clock-names = "clk_sfc", "hclk_sfc";
		clocks = <0x02 0xa1 0x02 0xa0>;
		compatible = "rockchip,sfc";
		interrupts = <0x00 0x87 0x04>;
		reg = <0x00 0xffc00000 0x00 0x4000>;
		status = "disabled";
	};

	sram@fe480000 {
		#address-cells = <0x01>;
		#size-cells = <0x01>;
		compatible = "mmio-sram";
		ranges = <0x00 0x00 0xfe480000 0xc000>;
		reg = <0x00 0xfe480000 0x00 0xc000>;

		rkvdec-sram@0 {
			phandle = <0x31>;
			reg = <0x00 0xc000>;
		};
	};

	syscon@ff300000 {
		compatible = "rockchip,rk3528-grf", "syscon", "simple-mfd";
		phandle = <0x0f>;
		reg = <0x00 0xff300000 0x00 0x90000>;

		grf-clock-controller {
			#clock-cells = <0x01>;
			compatible = "rockchip,rk3528-grf-cru";
			phandle = <0x7f>;
		};

		reboot-mode {
			compatible = "syscon-reboot-mode";
			mode-bootloader = <0x5242c301>;
			mode-charge = <0x5242c30b>;
			mode-fastboot = <0x5242c309>;
			mode-loader = <0x5242c301>;
			mode-normal = <0x5242c300>;
			mode-panic = <0x5242c307>;
			mode-recovery = <0x5242c303>;
			mode-ums = <0x5242c30c>;
			mode-watchdog = <0x5242c308>;
			offset = <0x70200>;
		};
	};

	syscon@ff540000 {
		compatible = "rockchip,rk3528-ioc-grf", "syscon";
		phandle = <0x82>;
		reg = <0x00 0xff540000 0x00 0x40000>;
	};

	thermal-zones {

		soc-thermal {
			polling-delay = <0x3e8>;
			polling-delay-passive = <0x14>;
			sustainable-power = <0x27e>;
			thermal-sensors = <0x1f 0x00>;

			cooling-maps {

				map0 {
					contribution = <0x400>;
					cooling-device = <0x03 0xffffffff 0xffffffff>;
					trip = <0x20>;
				};

				map1 {
					contribution = <0x400>;
					cooling-device = <0x21 0xffffffff 0xffffffff>;
					trip = <0x20>;
				};
			};

			trips {

				soc-crit {
					hysteresis = <0x7d0>;
					temperature = <0x1d4c0>;
					type = "critical";
				};

				trip-point-0 {
					hysteresis = <0x7d0>;
					temperature = <0x17318>;
					type = "passive";
				};

				trip-point-1 {
					hysteresis = <0x7d0>;
					phandle = <0x20>;
					temperature = <0x1adb0>;
					type = "passive";
				};
			};
		};
	};

	timer {
		compatible = "arm,armv8-timer";
		interrupts = <0x01 0x0d 0xf08 0x01 0x0e 0xf08 0x01 0x0b 0xf08 0x01 0x0a 0xf08>;
	};

	timer@ffab0000 {
		clock-names = "pclk", "timer";
		clocks = <0x02 0x69 0x02 0x6a>;
		compatible = "rockchip,rk3528-timer", "rockchip,rk3288-timer";
		interrupts = <0x00 0x1f 0x04>;
		reg = <0x00 0xffab0000 0x00 0x20>;
	};

	tsadc@ffad0000 {
		#thermal-sensor-cells = <0x01>;
		assigned-clock-rates = <0x124f80 0xb71b00>;
		assigned-clocks = <0x02 0x103 0x02 0x104>;
		clock-names = "tsadc", "tsadc_tsen", "apb_pclk";
		clocks = <0x02 0x103 0x02 0x104 0x02 0x102>;
		compatible = "rockchip,rk3528-tsadc";
		interrupts = <0x00 0x8b 0x04>;
		nvmem-cell-names = "trim_l", "trim_h";
		nvmem-cells = <0x57 0x58>;
		phandle = <0x1f>;
		reg = <0x00 0xffad0000 0x00 0x400>;
		reset-names = "tsadc", "tsadc-apb";
		resets = <0x02 0x20f 0x02 0x20e>;
		rockchip,grf = <0x0f>;
		rockchip,hw-tshut-mode = <0x00>;
		rockchip,hw-tshut-polarity = <0x00>;
		rockchip,hw-tshut-temp = <0x1d4c0>;
		status = "okay";
	};

	tve@ff880000 {
		clock-names = "hclk", "pclk_vdac", "dclk", "dclk_4x";
		clocks = <0x02 0x166 0x02 0x18f 0x02 0x167 0x02 0x168>;
		compatible = "rockchip,rk3528-tve";
		interrupts = <0x00 0x70 0x04>;
		nvmem-cell-names = "out-current", "version";
		nvmem-cells = <0x3b 0x3c>;
		reg = <0x00 0xff880000 0x00 0x4000 0x00 0xffde0000 0x00 0x300>;
		rockchip,grf = <0x0f>;
		rockchip,lumafilter0 = <0xff80006>;
		rockchip,lumafilter1 = <0x90010>;
		rockchip,lumafilter2 = <0xffb0fd8>;
		rockchip,lumafilter3 = <0x80057>;
		rockchip,lumafilter4 = <0xfef0f64>;
		rockchip,lumafilter5 = <0x16010a>;
		rockchip,lumafilter6 = <0xf830df7>;
		rockchip,lumafilter7 = <0x8de055f>;
		rockchip,tve-upsample = <0x02>;
		status = "okay";

		ports {
			#address-cells = <0x01>;
			#size-cells = <0x00>;

			port@0 {
				#address-cells = <0x01>;
				#size-cells = <0x00>;
				reg = <0x00>;

				endpoint@0 {
					phandle = <0x37>;
					reg = <0x00>;
					remote-endpoint = <0x17>;
					status = "okay";
				};
			};
		};
	};

	usb2-phy@ffdf0000 {
		#clock-cells = <0x00>;
		clock-names = "phyclk", "apb_pclk";
		clocks = <0x02 0x1ab 0x02 0x1aa>;
		compatible = "rockchip,rk3528-usb2phy";
		phandle = <0x25>;
		reg = <0x00 0xffdf0000 0x00 0x10000>;
		rockchip,usbgrf = <0x0f>;
		status = "okay";

		host-port {
			#phy-cells = <0x00>;
			interrupt-names = "linestate";
			interrupts = <0x00 0x96 0x04>;
			phandle = <0x26>;
			phy-supply = <0x80>;
			status = "okay";
		};

		otg-port {
			#phy-cells = <0x00>;
			interrupt-names = "otg-bvalid", "otg-id", "linestate";
			interrupts = <0x00 0x92 0x04 0x00 0x93 0x04 0x00 0x94 0x04>;
			phandle = <0x24>;
			phy-supply = <0x80>;
			status = "okay";
		};
	};

	usb@ff100000 {
		clock-names = "usbhost", "arbiter", "utmi";
		clocks = <0x02 0x1a0 0x02 0x1a1 0x25>;
		compatible = "generic-ehci";
		interrupts = <0x00 0x8f 0x04>;
		phy-names = "usb2-phy";
		phys = <0x26>;
		reg = <0x00 0xff100000 0x00 0x40000>;
		status = "okay";
	};

	usb@ff140000 {
		clock-names = "usbhost", "arbiter", "utmi";
		clocks = <0x02 0x1a0 0x02 0x1a1 0x25>;
		compatible = "generic-ohci";
		interrupts = <0x00 0x90 0x04>;
		phy-names = "usb2-phy";
		phys = <0x26>;
		reg = <0x00 0xff140000 0x00 0x40000>;
		status = "okay";
	};

	usbdrd {
		#address-cells = <0x02>;
		#size-cells = <0x02>;
		clock-names = "ref_clk", "suspend_clk", "bus_clk";
		clocks = <0x02 0x106 0x02 0x107 0x02 0x105>;
		compatible = "rockchip,rk3528-dwc3", "rockchip,rk3399-dwc3";
		ranges;
		status = "okay";

		dwc3@fe500000 {
			compatible = "snps,dwc3";
			dr_mode = "otg";
			extcon = <0x25>;
			interrupts = <0x00 0x98 0x04>;
			maximum-speed = "high-speed";
			phy-names = "usb2-phy";
			phy_type = "utmi_wide";
			phys = <0x24>;
			quirk-skip-phy-init;
			reg = <0x00 0xfe500000 0x00 0x400000>;
			reset-names = "usb3-otg";
			resets = <0x02 0x211>;
			snps,dis-del-phy-power-chg-quirk;
			snps,dis-tx-ipgap-linecheck-quirk;
			snps,dis-u1-entry-quirk;
			snps,dis-u2-entry-quirk;
			snps,dis-u2-freeclk-exists-quirk;
			snps,dis_enblslpm_quirk;
			snps,dis_rxdet_inp3_quirk;
			snps,dis_u2_susphy_quirk;
			snps,parkmode-disable-hs-quirk;
			snps,parkmode-disable-ss-quirk;
			snps,usb2-lpm-disable;
			status = "okay";
		};
	};

	vcc-3v3-s3 {
		compatible = "regulator-fixed";
		regulator-always-on;
		regulator-boot-on;
		regulator-max-microvolt = <0x325aa0>;
		regulator-min-microvolt = <0x325aa0>;
		regulator-name = "vcc_3v3_s3";
		vin-supply = <0x98>;
	};

	vcc-ddr-s3 {
		compatible = "regulator-fixed";
		regulator-always-on;
		regulator-boot-on;
		regulator-max-microvolt = <0x124f80>;
		regulator-min-microvolt = <0x124f80>;
		regulator-name = "vcc_ddr_s3";
		vin-supply = <0x98>;
	};

	vcc5v0-host-regulator {
		compatible = "regulator-fixed";
		enable-active-high;
		gpio = <0x78 0x0c 0x00>;
		phandle = <0x80>;
		pinctrl-0 = <0x99>;
		pinctrl-names = "default";
		regulator-always-on;
		regulator-boot-on;
		regulator-max-microvolt = <0x4c4b40>;
		regulator-min-microvolt = <0x4c4b40>;
		regulator-name = "vcc5v0_host";
		vin-supply = <0x98>;
	};

	vcc5v0-sys {
		compatible = "regulator-fixed";
		phandle = <0x98>;
		regulator-always-on;
		regulator-boot-on;
		regulator-max-microvolt = <0x4c4b40>;
		regulator-min-microvolt = <0x4c4b40>;
		regulator-name = "vcc5v0_sys";
		vin-supply = <0x97>;
	};

	vdd-0v9-s3 {
		compatible = "regulator-fixed";
		regulator-always-on;
		regulator-boot-on;
		regulator-max-microvolt = <0xdbba0>;
		regulator-min-microvolt = <0xdbba0>;
		regulator-name = "vdd_0v9_s3";
		vin-supply = <0x98>;
	};

	vdd-1v8-s3 {
		compatible = "regulator-fixed";
		phandle = <0x59>;
		regulator-always-on;
		regulator-boot-on;
		regulator-max-microvolt = <0x1b7740>;
		regulator-min-microvolt = <0x1b7740>;
		regulator-name = "vdd_1v8_s3";
		vin-supply = <0x98>;
	};

	vdd-cpu {
		compatible = "pwm-regulator";
		phandle = <0x0a>;
		pwm-supply = <0x98>;
		pwms = <0x9b 0x00 0x1388 0x01>;
		regulator-always-on;
		regulator-boot-on;
		regulator-init-microvolt = <0xe8aa8>;
		regulator-max-microvolt = <0x125368>;
		regulator-min-microvolt = <0xb6210>;
		regulator-name = "vdd_cpu";
		regulator-settling-time-up-us = <0xfa>;
		status = "okay";
	};

	vdd-logic {
		compatible = "pwm-regulator";
		phandle = <0x1a>;
		pwm-supply = <0x98>;
		pwms = <0x9a 0x00 0x1388 0x01>;
		regulator-always-on;
		regulator-boot-on;
		regulator-init-microvolt = <0xdbba0>;
		regulator-max-microvolt = <0xf59b0>;
		regulator-min-microvolt = <0xaba18>;
		regulator-name = "vdd_logic";
		regulator-settling-time-up-us = <0xfa>;
		status = "okay";
	};

	vdpp@ff861000 {
		assigned-clock-rates = <0x1443fd00 0x1443fd00>;
		assigned-clocks = <0x02 0x14e 0x02 0x14f>;
		clock-names = "aclk", "hclk", "sclk";
		clocks = <0x02 0x14e 0x02 0x14d 0x02 0x14f>;
		compatible = "rockchip,vdpp-v1";
		interrupts = <0x00 0x6a 0x04>;
		iommus = <0x39>;
		reg = <0x00 0xff861000 0x00 0x100 0x00 0xff862000 0x00 0x900>;
		reg-names = "vdpp_regs", "zme_regs";
		reset-names = "shared_rst_a", "shared_rst_h", "shared_rst_s";
		resets = <0x02 0x27b 0x02 0x27a 0x02 0x27c>;
		rockchip,disable-auto-freq;
		rockchip,grf = <0x0f>;
		rockchip,grf-mem-offset = <0x600e0>;
		rockchip,grf-mem-values = <0xf0040000 0xf004f004>;
		rockchip,normal-rates = <0x1443fd00 0x00 0x1443fd00>;
		rockchip,resetgroup-node = <0x03>;
		rockchip,srv = <0x30>;
		rockchip,taskqueue-node = <0x03>;
		status = "okay";
	};

	vdpu@ff7c0400 {
		assigned-clock-rates = <0x11e1a300>;
		assigned-clocks = <0x02 0x9c>;
		clock-names = "aclk_vcodec", "hclk_vcodec";
		clocks = <0x02 0x9c 0x02 0x9d>;
		compatible = "rockchip,vpu-decoder-v2";
		interrupt-names = "irq_dec";
		interrupts = <0x00 0x62 0x04>;
		iommus = <0x33>;
		reg = <0x00 0xff7c0400 0x00 0x400>;
		reset-names = "shared_video_a", "shared_video_h";
		resets = <0x02 0x199 0x02 0x19a>;
		rockchip,disable-auto-freq;
		rockchip,grf = <0x0f>;
		rockchip,grf-mem-offset = <0x40034>;
		rockchip,grf-mem-values = <0xf040000 0xf040f04>;
		rockchip,normal-rates = <0x11e1a300 0x00>;
		rockchip,resetgroup-node = <0x02>;
		rockchip,srv = <0x30>;
		rockchip,taskqueue-node = <0x02>;
		status = "okay";
	};

	vop@ff840000 {
		assigned-clock-parents = <0x34>;
		assigned-clocks = <0x02 0x155>;
		clock-names = "aclk_vop", "hclk_vop", "dclk_vp0", "dclk_vp1";
		clocks = <0x02 0x157 0x02 0x154 0x02 0x155 0x02 0x156>;
		compatible = "rockchip,rk3528-vop";
		interrupts = <0x00 0x6d 0x04>;
		iommus = <0x35>;
		reg = <0x00 0xff840000 0x00 0x3000 0x00 0xff845000 0x00 0x1000 0x00 0xff846400 0x00 0x800>;
		reg-names = "regs", "gamma_lut", "acm_regs";
		rockchip,grf = <0x0f>;
		status = "okay";

		ports {
			#address-cells = <0x01>;
			#size-cells = <0x00>;
			phandle = <0x13>;

			port@0 {
				#address-cells = <0x01>;
				#size-cells = <0x00>;
				reg = <0x00>;

				endpoint@0 {
					phandle = <0x16>;
					reg = <0x00>;
					remote-endpoint = <0x36>;
				};
			};

			port@1 {
				#address-cells = <0x01>;
				#size-cells = <0x00>;
				reg = <0x01>;

				endpoint@0 {
					phandle = <0x17>;
					reg = <0x00>;
					remote-endpoint = <0x37>;
				};
			};
		};
	};

	watchdog@ffac0000 {
		clock-names = "tclk", "pclk";
		clocks = <0x02 0x73 0x02 0x72>;
		compatible = "snps,dw-wdt";
		interrupts = <0x00 0x1c 0x04>;
		reg = <0x00 0xffac0000 0x00 0x100>;
		status = "disabled";
	};

	wireless-wlan {
		WIFI,reset_gpio = <0x9d 0x02 0x00>;
		compatible = "wlan-platdata";
		pinctrl-0 = <0x9c>;
		pinctrl-names = "default";
		rockchip,grf = <0x0f>;
		status = "okay";
		wifi_chip_type = [00];
	};
};
